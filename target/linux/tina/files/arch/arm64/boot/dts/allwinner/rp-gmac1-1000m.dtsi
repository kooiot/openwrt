&gmac1 {
    phy-mode = "rgmii";
    pinctrl-names = "default", "sleep";
    pinctrl-0 = <&gmac1_pins_default>;
    pinctrl-1 = <&gmac1_pins_sleep>;
    sunxi,phy-clk-type = <0>;
    tx-delay = <3>;
    rx-delay = <4>;
    status = "okay";
};

&mdio1 {
    status = "okay";
};

&gmac1_phy0 {
    reg = <0x1>;
    max-speed = <1000>;  /* Max speed capability */
    /* PHY datasheet rst time */
    reset-assert-us = <10000>;
    reset-deassert-us = <200000>;
};

