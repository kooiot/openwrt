## target/linux/tina/files/bsp/drivers/can/Kconfig
```kconfig
# SPDX-License-Identifier: GPL-2.0-only

menu "CAN Drivers"
	depends on AW_BSP

config AW_CAN_SUN55I
	depends on CAN && ARCH_SUN55IW6
	tristate "Allwinner SUN55I T536 CAN controller"
	default n
	help
	  if say Y here, you can use T536 CAN controller.
config AW_CAN_SUN8I
	depends on CAN && ARCH_SUN8IW22
	tristate "Allwinner SUN8I T153 CAN controller"
	default n
	help
	  if say Y here, you can use T153 CAN controller.

endmenu
```

## target/linux/tina/files/bsp/drivers/cpufreq/Kconfig
```kconfig
# SPDX-License-Identifier: GPL-2.0-only

source "bsp/drivers/cpufreq/cpufreq-linux-$(VERSION).$(PATCHLEVEL)/Kconfig"


config AW_VF_FOR_T536
        tristate "VF for T536 Soc"
        default n
        help
            if say Y here, you can use vf for T536 Soc

config AW_VF_BALANCE_PERFORMANCE
        tristate "VF balance performance for T536 Soc"
        depends on AW_VF_FOR_T536
        default n
        help
            if say Y here, you can use vf balance performance for T536 Soc

config AW_VF_FOR_T153
        tristate "VF for T153 Soc"
        default n
        help
            if say Y here, you can use vf for T153 Soc

config AW_VF_NPU_EXT_DCDC
        tristate "VF ext dcdc for MR536 Soc"
        default n
        help
            if say Y here, you can use vf ext dcdc for MR536 Soc
```

## target/linux/tina/files/bsp/drivers/ddrecc/Kconfig
```kconfig
# SPDX-License-Identifier: GPL-2.0-only

menu "Dump-IO Drivers"
	depends on AW_BSP

config AW_DDRECC
	tristate "Dump-IO Support for Allwinner SoCs"
	depends on AW_BSP
	default y
	help
	  Say y here if you want to support sunxi dump-io module.
	  The dump-io module is used to dump registers of any device.
	  When in doubt, say "Y".

endmenu
```

## target/linux/tina/files/bsp/drivers/flash_wr/Kconfig
```kconfig
menuconfig HZHY_FLASH_LOAD
	tristate "hzhy fpag firmware load driver"
	default n
	help
	  hzhy fpag.bin load.

if HZHY_FLASH_LOAD
	
config HZHY_SPI_FLASH_LOAD
	tristate "Load the firmware to the SPI-flash driver"
	help
	  Load the fpag firmware to the SPI flash.

	default n

endif
```

## target/linux/tina/files/bsp/drivers/hzhy_gpio/Kconfig
```kconfig
menuconfig HZHY_GPIO_SUBSYS
	tristate "hzhy gpio subsystem"
	default n
	help
	  hzhy gpio-device subsystem.

if HZHY_GPIO_SUBSYS
	
config HZHY_GPIO_WDT
	tristate "hzhy gpio based watchdog driver"
	default n

endif
```

## target/linux/tina/files/bsp/drivers/l3_cache/Kconfig
```kconfig
# SPDX-License-Identifier: GPL-2.0-only

menu "L3 Cache Drivers"
	depends on AW_BSP && ARM64

config AW_L3_CACHE_PARTITION
	tristate "Allwinner aarch64 DSU L3 Cache Partition Driver"
	default n
	help
	  if say Y here, you can use aarch64 DSU L3 Cache Partition Driver.

endmenu
```

## target/linux/tina/files/bsp/drivers/lbc/Kconfig
```kconfig
# SPDX-License-Identifier: GPL-2.0-only
menu "Localbus Drivers"
	depends on AW_BSP

config AW_LBC
	bool "support localbus drivers"

if AW_LBC

choice
	prompt "select lbc driver version"
	default AW_LBC_V1

config AW_LBC_V1
	bool "Local Bus Ctrl Support for sun55iw6 Allwinner SoCs"
	help
		Support the Local Bus Ctrl driver for sun55iw6 Allwinner platforms.

config AW_LBC_V2
	bool "Local Bus Ctrl Support for sun8iw22 Allwinner SoCs"
	help
		Support the Local Bus Ctrl driver for sun8iw22 Allwinner platforms.

endchoice

config AW_SPI_LBC_TEST
	tristate "Sun8iw22 Controlling localbus registers with spi"
	depends on AW_BSP && AW_SPI_NG && AW_LBC_V2
	help
		Support Controlling localbus registers with spi in sun8iw22

endif

endmenu
```

## target/linux/tina/files/bsp/drivers/misc/awmem/Kconfig
```kconfig
# SPDX-License-Identifier: GPL-2.0

config AWMEM
  tristate "allwinner memory allocation driver"
  default n
  help
    allwinner memory allocation driver.
```

## target/linux/tina/files/bsp/drivers/net/phy/Kconfig
```kconfig
# SPDX-License-Identifier: GPL-2.0-only
#
# PHY Layer Configuration
#

menu "PHY"
	depends on PHYLIB

config AW_MAXIO_PHY
	tristate "MAXIO PHYs"
	help
	Supports the Maxio MAExxxx PHY.

config AW_MOTORCOMM_PHY
	tristate "Motorcomm PHYs"
	help
	  Supports the YT8010, YT8011, YT8510, YT8511, YT8512, YT8522, 
	  YT8521S, YT8531, YT8531S, YT8543, YT8614, YT8614Q, YT8618, 
	  YT8821 PHYs.

endmenu
```

## target/linux/tina/files/bsp/drivers/net/wireless/Kconfig
```kconfig
menu "Wireless LAN"
	depends on !S390
	depends on NET

if WLAN

source "bsp/drivers/net/wireless/xr819/Kconfig"
source "bsp/drivers/net/wireless/xr829/Kconfig"
endif

endmenu
```

## target/linux/tina/files/bsp/drivers/remoteproc/trace_event/Kconfig
```kconfig
menuconfig COMPONENTS_EVENTS
	bool "RTOS Event Support"
	default n
	help
	  RTOS Event Support.

if COMPONENTS_EVENTS
config MAX_EVENT_BUFFER_SIZE
	int "Max Event Buffer Size(Kb)"
	default 32

config MAX_TASK_NAME_CNT
	int "max record task name"
	default 32

config MAX_TASK_NAME_LEN
	int "max record task name len"
	default 32

choice
	prompt "print timestamp formet"
	default EVENTS_PRINT_TIME_FMT_FLOAT
config EVENTS_PRINT_TIME_FMT_LONG
	bool "print timestamp with %ld"
config EVENTS_PRINT_TIME_FMT_FLOAT
	bool "print timestamp with %0.6f"
config EVENTS_PRINT_TIME_FMT_DOUBLE
	bool "print timestamp with %0.6lf"
endchoice

choice
	prompt "Default Writer Work Mode"
	default EVENTS_WRITER_DEFAULT_OVERWRITE_DIRECTLY
config EVENTS_WRITER_DEFAULT_OVERWRITE_DIRECTLY
	bool "Overwrite directly"

config EVENTS_WRITER_DEFAULT_DISCARD_NEW_DATA
	bool "Discard new data"

endchoice

config EVENTS_WRITER_FLUSH_CACHE_LINE_NUM
	int "Writer Flush Cache Line Num"
	default 2

source "components/common/aw/trace_event/event.Kconfig"

endif # if COMPONENTS_EVENTS
```

## target/linux/tina/files/bsp/drivers/spi/Kconfig
```kconfig
# SPDX-License-Identifier: GPL-2.0-only

menu "SPI Drivers"
	depends on AW_BSP

config AW_SPI
	tristate "SPI Support for Allwinner SoCs"
	depends on AW_BSP && OF
	default n
	select SPI
	help
	  Enable SPI controllers on Allwinner SoCs.

config AW_SPI_ATOMIC_XFER
	bool "Support atomic xfer function"
	depends on AW_SPI
	default n
	help
	  Enable SPI controller atomic xfer function, support transfer under
	  no-irq/no-dma/no-schedule/no-suspend-resume env. (Such as kernel panic)

config SPI_ESAM
	tristate "SPI ESAM driver support for most esam chips"
	depends on AW_SPI
	default n
	help
	 if you want to use esam chips, please say yes
	 and this chips's model name is sc1161y 
	

endmenu
```

## target/linux/tina/files/bsp/drivers/standby/Kconfig
```kconfig
# SPDX-License-Identifier: GPL-2.0-only
#
# sunxi standby debug config.
menu "Standby Debugging Drivers"
	depends on AW_BSP

config AW_STANDBY_DEBUG
	tristate "Allwinner Standby Debugging Driver"
	depends on AW_BSP && PM && (ARM || ARM64)
	default y
	help
	  Say y here if you want to support standby debug module.
	  The standby debug module is used to debug system suspend.
	  When in doubt, say "Y".

config AW_STANDBY_PM_MSGBOX
	tristate "Allwinner PM Msgbox Driver"
	depends on AW_BSP && PM && (ARM || ARM64) && MAILBOX
	default y
	help
	  Say y here if you want to support standby debug module.
	  The standby debug module is used to debug system suspend.
	  When in doubt, say "Y".

endmenu
```

## target/linux/tina/files/bsp/drivers/xenomai/Kconfig
```kconfig
# SPDX-License-Identifier: GPL-2.0-only

menu "Xenomai Device Drivers"

config AW_XENOMAI_DRIVERS
	bool "Enable allwinner drivers for RTDM devices"
	depends on XENO_OPT_RTDM_COMPAT_DEVNODE
	default n
	help
		Enable allwinner drivers for RTDM devices

config AW_XENOMAI_SDIO_DRIVERS
	bool "Enable allwinner drivers for RTDM sdio"
	depends on AW_XENOMAI_DRIVERS
	default n
	help
		Enable allwinner drivers for RTDM devices

source "bsp//drivers/xenomai/sdio/Kconfig"
source "bsp//drivers/xenomai/spi/Kconfig"
source "bsp//drivers/xenomai/can/Kconfig"

endmenu
```

## target/linux/tina/files/bsp/drivers/xenomai/can/Kconfig
```kconfig
# SPDX-License-Identifier: GPL-2.0-only

menu "AW Real-time CAN Drivers"
	depends on AW_XENOMAI_DRIVERS

config AW_XENO_CAN_SUN8I
	#depends on CAN
	tristate "Allwinner Xenomai SUN8I T153 CAN controller"
	default n
	help
	  if say Y here, you can use Xenomai T153 CAN controller.

endmenu
```

## target/linux/tina/files/bsp/drivers/xenomai/sdio/Kconfig
```kconfig
# SPDX-License-Identifier: GPL-2.0

menu "XENO SDIO"

config XENO_DRIVERS_SDIO
       tristate "xenomai sdio"
       depends on AW_XENOMAI_SDIO_DRIVERS
       default n

source "bsp//drivers/xenomai/sdio/host-bsp/Kconfig"
endmenu
```

## target/linux/tina/files/bsp/drivers/xenomai/sdio/host-bsp/Kconfig
```kconfig
# SPDX-License-Identifier: GPL-2.0-only
#
# MMC/SD host controller drivers
#

menu "SD/MMC Drivers"
	depends on AW_BSP

config AW_MMC_RTDM
	tristate "Allwinner SD/MMC Host Controller Support"
	default n

	help
	  This selects support for the SD/MMC Host Controller on
	  Allwinner SoCs.

config AW_MMC_V4P1X_RTDM
	bool "V4P1X SD/MMC Host Controller Support"
	depends on AW_MMC
	default y
	help
	  V4P1X SD/MMC Host Contrller support.

config AW_MMC_V4P00X_RTDM
	bool "V4P00X SD/MMC Host Controller Support"
	depends on AW_MMC
	default y
	help
	  V4P00X SD/MMC Host Contrller support.

config AW_MMC_V4P10X_RTDM
	bool "V4P10X SD/MMC Host Controller Support"
	depends on AW_MMC
	default n
	help
	  V4P10X SD/MMC Host Contrller support.

config AW_MMC_V4P5X_RTDM
	bool "V4P5X SD/MMC Host Controller Support"
	depends on AW_MMC
	default y
	help
	  V4P5X SD/MMC Host Contrller support.

config AW_MMC_V5P3X_RTDM
	bool "V5P3X SD/MMC Host Controller Support"
	depends on AW_MMC
	default y
	help
	  V5P3X SD/MMC Host Contrller support.

config AW_MMC_DEBUG_RTDM
	bool "SD/MMC Host Controller debug support"
	depends on AW_MMC
	default n
	help
	  AW SD/MMC Host Contrller debug support.

config AW_MMC_PRE_DBGLVL_RTDM
        int "Pre-defined debug level for AW MMC driver"
	depends on AW_MMC && AW_MMC_DEBUG
	default 3

endmenu
```

## thingslink/vanxoak-hd-rk3506-iot-spinand_defconfig
```kconfig
CONFIG_TARGET_rockchip=y
CONFIG_TARGET_rockchip_armv7=y
CONFIG_TARGET_rockchip_armv7_DEVICE_vanxoak_vx-hd-rk3506-iot-spinand=y
CONFIG_BUSYBOX_CUSTOM=y
CONFIG_BRCMFMAC_PCIE=y
CONFIG_BRCMFMAC_SDIO=y
CONFIG_BRCMFMAC_USB=y
CONFIG_BUSYBOX_CONFIG_BC=y
CONFIG_DRIVER_11AC_SUPPORT=y
CONFIG_PACKAGE_brcmfmac-firmware-usb=y
CONFIG_PACKAGE_kmod-brcmfmac=y
CONFIG_PACKAGE_kmod-brcmutil=y
CONFIG_PACKAGE_kmod-phy-realtek=y
CONFIG_PACKAGE_kmod-rtc-hym8563=y
CONFIG_PACKAGE_kmod-rtc-sd3078=y
CONFIG_PACKAGE_libreadline=y
# CONFIG_TARGET_ROOTFS_EXT4FS is not set
CONFIG_TARGET_ROOTFS_PARTSIZE=100
```

## thingslink/vanxoak-hd-rk3506g-iot-m-spinand_defconfig
```kconfig
CONFIG_TARGET_rockchip=y
CONFIG_TARGET_rockchip_armv7=y
CONFIG_TARGET_rockchip_armv7_DEVICE_vanxoak_vx-hd-rk3506g-m-iot-spinand=y
CONFIG_BUSYBOX_CUSTOM=y
CONFIG_BRCMFMAC_PCIE=y
CONFIG_BRCMFMAC_SDIO=y
CONFIG_BRCMFMAC_USB=y
CONFIG_BUSYBOX_CONFIG_BC=y
CONFIG_DRIVER_11AC_SUPPORT=y
CONFIG_LUCI_LANG_zh_Hans=y
CONFIG_PACKAGE_aic8800-usb-firmware=y
CONFIG_PACKAGE_brcmfmac-firmware-usb=y
CONFIG_PACKAGE_kmod-aic8800-usb=y
CONFIG_PACKAGE_kmod-brcmfmac=y
CONFIG_PACKAGE_kmod-brcmutil=y
CONFIG_PACKAGE_kmod-hwmon-core=y
CONFIG_PACKAGE_kmod-phy-realtek=y
CONFIG_PACKAGE_libreadline=y
CONFIG_PACKAGE_luci-i18n-base-zh-cn=y
CONFIG_PACKAGE_luci-i18n-firewall-zh-cn=y
CONFIG_PACKAGE_luci-i18n-freeioe-zh-cn=y
CONFIG_PACKAGE_luci-i18n-package-manager-zh-cn=y
# CONFIG_TARGET_ROOTFS_EXT4FS is not set
CONFIG_TARGET_ROOTFS_PARTSIZE=100
```

## thingslink/vanxoak-hd-rk3506g-iot-spinand_symlink_defconfig
```kconfig
CONFIG_TARGET_rockchip=y
CONFIG_TARGET_rockchip_armv7=y
CONFIG_TARGET_rockchip_armv7_DEVICE_vanxoak_vx-hd-rk3506-iot-spinand=y
CONFIG_BUSYBOX_CUSTOM=y
CONFIG_BRCMFMAC_PCIE=y
CONFIG_BRCMFMAC_SDIO=y
CONFIG_BRCMFMAC_USB=y
CONFIG_BUSYBOX_CONFIG_BC=y
CONFIG_DRIVER_11AC_SUPPORT=y
CONFIG_LUCI_LANG_zh_Hans=y
CONFIG_PACKAGE_brcmfmac-firmware-usb=y
# CONFIG_PACKAGE_freeioe is not set
CONFIG_PACKAGE_kmod-bluetooth=y
CONFIG_PACKAGE_kmod-brcmfmac=y
CONFIG_PACKAGE_kmod-brcmutil=y
CONFIG_PACKAGE_kmod-crypto-ecb=y
CONFIG_PACKAGE_kmod-crypto-ecdh=y
CONFIG_PACKAGE_kmod-crypto-kpp=y
CONFIG_PACKAGE_kmod-hid=y
CONFIG_PACKAGE_kmod-input-core=y
CONFIG_PACKAGE_kmod-input-evdev=y
CONFIG_PACKAGE_kmod-lib-crc16=y
CONFIG_PACKAGE_kmod-phy-realtek=y
CONFIG_PACKAGE_libopenssl-v1=y
CONFIG_PACKAGE_libreadline=y
# CONFIG_PACKAGE_luci-app-freeioe is not set
CONFIG_PACKAGE_luci-i18n-base-zh-cn=y
CONFIG_PACKAGE_luci-i18n-firewall-zh-cn=y
CONFIG_PACKAGE_luci-i18n-package-manager-zh-cn=y
# CONFIG_PACKAGE_skynet is not set
CONFIG_PACKAGE_symlink-psn=y
CONFIG_PACKAGE_yolink=y
# CONFIG_TARGET_ROOTFS_EXT4FS is not set
CONFIG_TARGET_ROOTFS_PARTSIZE=100
CONFIG_OPENSSL_ENGINE_BUILTIN=y
# CONFIG_OPENSSL_ENGINE_BUILTIN_AFALG is not set
# CONFIG_OPENSSL_ENGINE_BUILTIN_DEVCRYPTO is not set
CONFIG_OPENSSL_WITH_SM234=y
CONFIG_PACKAGE_process-monitor=y
```

## thingslink/vanxoak-hd-rk3506g-m-iot-spinand_defconfig
```kconfig
CONFIG_TARGET_rockchip=y
CONFIG_TARGET_rockchip_armv7=y
CONFIG_TARGET_rockchip_armv7_DEVICE_vanxoak_vx-hd-rk3506g-m-iot-spinand=y
CONFIG_BUSYBOX_CUSTOM=y
CONFIG_BRCMFMAC_PCIE=y
CONFIG_BRCMFMAC_SDIO=y
CONFIG_BRCMFMAC_USB=y
CONFIG_BUSYBOX_CONFIG_BC=y
CONFIG_DRIVER_11AC_SUPPORT=y
CONFIG_LUCI_LANG_zh_Hans=y
CONFIG_PACKAGE_aic8800-usb-firmware=y
CONFIG_PACKAGE_brcmfmac-firmware-usb=y
CONFIG_PACKAGE_canutils=y
CONFIG_PACKAGE_canutils-can-calc-bit-timing=y
CONFIG_PACKAGE_canutils-candump=y
CONFIG_PACKAGE_canutils-cansend=y
CONFIG_PACKAGE_canutils-cansniffer=y
CONFIG_PACKAGE_comgt-ncm=y
CONFIG_PACKAGE_glib2=y
CONFIG_PACKAGE_kmod-aic8800-usb=y
CONFIG_PACKAGE_kmod-brcmfmac=y
CONFIG_PACKAGE_kmod-brcmutil=y
CONFIG_PACKAGE_kmod-can=y
CONFIG_PACKAGE_kmod-can-rockchip-rk3576=y
CONFIG_PACKAGE_kmod-hwmon-core=y
CONFIG_PACKAGE_kmod-phy-realtek=y
CONFIG_PACKAGE_kmod-regulator-userspace-consumer=y
CONFIG_PACKAGE_kmod-usb-net-huawei-cdc-ncm=y
CONFIG_PACKAGE_libattr=y
CONFIG_PACKAGE_libffi=y
CONFIG_PACKAGE_libpcre2=y
CONFIG_PACKAGE_libreadline=y
CONFIG_PACKAGE_luci-i18n-base-zh-cn=y
CONFIG_PACKAGE_luci-i18n-firewall-zh-cn=y
CONFIG_PACKAGE_luci-i18n-freeioe-zh-cn=y
CONFIG_PACKAGE_luci-i18n-package-manager-zh-cn=y
CONFIG_PACKAGE_luci-proto-ncm=y
CONFIG_PACKAGE_minicom=y
CONFIG_PACKAGE_tio=y
CONFIG_PCRE2_JIT_ENABLED=y
# CONFIG_TARGET_ROOTFS_EXT4FS is not set
CONFIG_TARGET_ROOTFS_PARTSIZE=100
# CONFIG_PACKAGE_kmod-can-raw is not set
```
