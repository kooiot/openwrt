// SPDX-License-Identifier: (GPL-2.0+ OR MIT)
/*
 * Copyright (c) 2026 KooIoT.com
 */

/dts-v1/;

#include "rk3506-vx-hd-rk3506g-m-v1.dtsi"

/ {
	model = "HD-RK3506G-M-IOT";
	compatible = "vanxoak,vx-hd-rk3506g-m-iot", "rockchip,rk3506";
};

