## thingslink/tlink_k4g_symlink_defconfig
```kconfig
CONFIG_TARGET_sunxi=y
CONFIG_TARGET_sunxi_cortexa7=y
CONFIG_TARGET_sunxi_cortexa7_DEVICE_kooiot_tlink-k4g=y
# CONFIG_KERNEL_NET_L3_MASTER_DEV is not set
CONFIG_KERNEL_PAGE_POOL=y
CONFIG_LCD4LINUX_CUSTOM_DRIVER_FW8888=y
CONFIG_LCD4LINUX_CUSTOM_DRIVER_GLCD2USB=y
CONFIG_LCD4LINUX_CUSTOM_DRIVER_LCD2USB=y
CONFIG_LCD4LINUX_CUSTOM_DRIVER_LEDMatrix=y
CONFIG_LCD4LINUX_CUSTOM_DRIVER_MatrixOrbital=y
CONFIG_LCD4LINUX_CUSTOM_DRIVER_MatrixOrbitalGX=y
CONFIG_LCD4LINUX_CUSTOM_DRIVER_NULL=y
CONFIG_LCD4LINUX_CUSTOM_DRIVER_PNG=y
CONFIG_LCD4LINUX_CUSTOM_DRIVER_USBLCD=y
CONFIG_LCD4LINUX_CUSTOM_NEEDS_libgd=y
CONFIG_LCD4LINUX_CUSTOM_NEEDS_libusb=y
CONFIG_LCD4LINUX_CUSTOM_NEEDS_ppp=y
CONFIG_LCD4LINUX_CUSTOM_PLUGIN_button_exec=y
CONFIG_LCD4LINUX_CUSTOM_PLUGIN_cpuinfo=y
CONFIG_LCD4LINUX_CUSTOM_PLUGIN_diskstats=y
CONFIG_LCD4LINUX_CUSTOM_PLUGIN_event=y
CONFIG_LCD4LINUX_CUSTOM_PLUGIN_exec=y
CONFIG_LCD4LINUX_CUSTOM_PLUGIN_file=y
CONFIG_LCD4LINUX_CUSTOM_PLUGIN_loadavg=y
CONFIG_LCD4LINUX_CUSTOM_PLUGIN_meminfo=y
CONFIG_LCD4LINUX_CUSTOM_PLUGIN_netdev=y
CONFIG_LCD4LINUX_CUSTOM_PLUGIN_netinfo=y
CONFIG_LCD4LINUX_CUSTOM_PLUGIN_ppp=y
CONFIG_LCD4LINUX_CUSTOM_PLUGIN_proc_stat=y
CONFIG_LCD4LINUX_CUSTOM_PLUGIN_statfs=y
CONFIG_LCD4LINUX_CUSTOM_PLUGIN_uname=y
CONFIG_LCD4LINUX_CUSTOM_PLUGIN_uptime=y
# CONFIG_LIBCURL_HTTP_AUTH is not set
CONFIG_LUCI_LANG_zh_Hans=y
CONFIG_MAKE_TOOLCHAIN=y
# CONFIG_PACKAGE_freeioe is not set
CONFIG_PACKAGE_kmod-mt76-core=y
CONFIG_PACKAGE_kmod-mt76-usb=y
CONFIG_PACKAGE_kmod-mt76x0-common=y
CONFIG_PACKAGE_kmod-mt76x02-common=y
CONFIG_PACKAGE_kmod-mt76x02-usb=y
CONFIG_PACKAGE_kmod-mt76x0u=y
CONFIG_PACKAGE_kmod-mt76x2-common=y
CONFIG_PACKAGE_kmod-mt76x2u=y
CONFIG_PACKAGE_kmod-rtl8192c-common=y
CONFIG_PACKAGE_kmod-rtl8192cu=y
CONFIG_PACKAGE_kmod-rtlwifi=y
CONFIG_PACKAGE_kmod-rtlwifi-usb=y
CONFIG_PACKAGE_kmod-usb-net-ipheth=y
CONFIG_PACKAGE_kmod-usb-net-rndis=y
CONFIG_PACKAGE_lcd4linux-custom=y
CONFIG_PACKAGE_libcleri=y
CONFIG_PACKAGE_libgd=y
CONFIG_PACKAGE_libiconv-full-full=m
CONFIG_PACKAGE_libimobiledevice=y
CONFIG_PACKAGE_libimobiledevice-glue=y
CONFIG_PACKAGE_libjpeg-turbo=y
CONFIG_PACKAGE_libopenssl-v1=y
CONFIG_PACKAGE_libpcre2=y
CONFIG_PACKAGE_libplist=y
CONFIG_PACKAGE_libpng=y
CONFIG_PACKAGE_libtatsu=y
CONFIG_PACKAGE_libusb-compat=y
CONFIG_PACKAGE_libusbmuxd=y
CONFIG_PACKAGE_libuv=y
CONFIG_PACKAGE_libwebp=y
CONFIG_PACKAGE_libxml2=y
# CONFIG_PACKAGE_luci-app-freeioe is not set
CONFIG_PACKAGE_luci-i18n-attendedsysupgrade-zh-cn=y
CONFIG_PACKAGE_luci-i18n-base-zh-cn=y
CONFIG_PACKAGE_luci-i18n-firewall-zh-cn=y
CONFIG_PACKAGE_luci-i18n-package-manager-zh-cn=y
CONFIG_PACKAGE_luci-i18n-ser2net-zh-cn=y
CONFIG_PACKAGE_phone-usb-tether=y
CONFIG_PACKAGE_rtl8192cu-firmware=y
CONFIG_PACKAGE_siridb-server=y
# CONFIG_PACKAGE_skynet is not set
CONFIG_PACKAGE_symlink-openssl-v1=y
CONFIG_PACKAGE_symlink-projects-symgrid-com=y
CONFIG_PACKAGE_symlink-psn=y
CONFIG_PACKAGE_tlink-usb2lcd=y
CONFIG_PACKAGE_usbmuxd=y
CONFIG_PACKAGE_yajl=y
CONFIG_PCRE2_JIT_ENABLED=y
CONFIG_SUNXI_SD_BOOT_PARTSIZE=20
CONFIG_TARGET_KERNEL_PARTSIZE=20
CONFIG_TARGET_ROOTFS_PARTSIZE=256
CONFIG_OPENSSL_ENGINE_BUILTIN=y
# CONFIG_OPENSSL_ENGINE_BUILTIN_AFALG is not set
# CONFIG_OPENSSL_ENGINE_BUILTIN_DEVCRYPTO is not set
CONFIG_OPENSSL_WITH_SM234=y
CONFIG_PACKAGE_liblua=y
CONFIG_PACKAGE_liblucihttp-lua=y
CONFIG_PACKAGE_libubus-lua=y
CONFIG_PACKAGE_lua=y
# CONFIG_PACKAGE_lua-examples is not set
CONFIG_PACKAGE_luci-lib-base=y
CONFIG_PACKAGE_luci-lib-ip=y
CONFIG_PACKAGE_luci-lib-jsonc=y
CONFIG_PACKAGE_luci-lib-nixio=y
CONFIG_PACKAGE_luci-lua-runtime=y
CONFIG_PACKAGE_process-monitor=y
CONFIG_PACKAGE_ucode-mod-lua=y
```
