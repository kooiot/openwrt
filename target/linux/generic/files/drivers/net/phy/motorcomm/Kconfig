## thingslink/tlink_k2x_defconfig
```kconfig
CONFIG_TARGET_sunxi=y
CONFIG_TARGET_sunxi_cortexa7=y
CONFIG_TARGET_sunxi_cortexa7_DEVICE_kooiot_tlink-k2x=y
CONFIG_KERNEL_DEVTMPFS=y
CONFIG_KERNEL_IO_URING=y
# CONFIG_LIBCURL_UNIX_SOCKETS is not set
CONFIG_LUCI_LANG_zh_Hans=y
CONFIG_MOSQUITTO_CTRL=y
CONFIG_MOSQUITTO_DYNAMIC_SECURITY=y
CONFIG_MOSQUITTO_LWS=y
CONFIG_MOSQUITTO_PASSWD=y
# CONFIG_OPENSSL_WITH_IDEA is not set
# CONFIG_OPENSSL_WITH_MDC2 is not set
CONFIG_OPENSSL_WITH_NPN=y
# CONFIG_OPENSSL_WITH_SEED is not set
# CONFIG_OPENSSL_WITH_WHIRLPOOL is not set
CONFIG_PACKAGE_attendedsysupgrade-common=y
CONFIG_PACKAGE_cJSON=y
CONFIG_PACKAGE_factory-tlink=m
CONFIG_PACKAGE_focas-ubus=m
CONFIG_PACKAGE_freeioe-hosts-kooiot-cn=y
CONFIG_PACKAGE_kmod-eeprom-93cx6=y
CONFIG_PACKAGE_kmod-lib-crc-itu-t=y
CONFIG_PACKAGE_kmod-motorcomm-yt8512c=y
CONFIG_PACKAGE_kmod-motorcomm-yt8521s=y
CONFIG_PACKAGE_kmod-mt7601u=y
CONFIG_PACKAGE_kmod-nf-nat6=y
CONFIG_PACKAGE_kmod-pwm-sun8i=y
CONFIG_PACKAGE_kmod-rt2800-lib=y
CONFIG_PACKAGE_kmod-rt2800-usb=y
CONFIG_PACKAGE_kmod-rt2x00-lib=y
CONFIG_PACKAGE_kmod-rt2x00-usb=y
CONFIG_PACKAGE_kmod-rtc-rx8010=y
CONFIG_PACKAGE_kmod-rtl8192c-common=y
CONFIG_PACKAGE_kmod-rtl8192cu=y
CONFIG_PACKAGE_kmod-rtl8xxxu=y
CONFIG_PACKAGE_kmod-rtlwifi=y
CONFIG_PACKAGE_kmod-rtlwifi-usb=y
CONFIG_PACKAGE_kmod-rtw88=y
CONFIG_PACKAGE_kmod-rtw88-8821c=y
CONFIG_PACKAGE_kmod-rtw88-8821cu=y
CONFIG_PACKAGE_kmod-rtw88-usb=y
CONFIG_PACKAGE_kmod-serial-xr14xx-usb=y
CONFIG_PACKAGE_kmod-sound-core=y
CONFIG_PACKAGE_kmod-sound-soc-core=y
CONFIG_PACKAGE_kmod-sound-soc-sunxi=y
CONFIG_PACKAGE_kmod-spi-bitbang=y
CONFIG_PACKAGE_kmod-usb-net-cdc-eem=y
CONFIG_PACKAGE_kmod-usb-net-cdc-mbim=y
CONFIG_PACKAGE_kmod-usb-net-rtl8150=y
CONFIG_PACKAGE_kmod-usb-net-rtl8152=y
CONFIG_PACKAGE_kmod-usb-otg-sunxi=y
CONFIG_PACKAGE_kmod-usb-serial-ch341=y
CONFIG_PACKAGE_kmod-usb-serial-cp210x=y
CONFIG_PACKAGE_kmod-usb-serial-pl2303=y
CONFIG_PACKAGE_libcap=y
CONFIG_PACKAGE_libcleri=y
CONFIG_PACKAGE_libgd=y
CONFIG_PACKAGE_libiconv-full-full=m
CONFIG_PACKAGE_libiwinfo-lua=y
CONFIG_PACKAGE_libjpeg-turbo=y
CONFIG_PACKAGE_libpcre2=y
CONFIG_PACKAGE_libpng=y
CONFIG_PACKAGE_libspeedtestcpp=y
CONFIG_PACKAGE_libusb-compat=y
CONFIG_PACKAGE_libuv=y
CONFIG_PACKAGE_libwebp=y
CONFIG_PACKAGE_libwebsockets-openssl=y
# CONFIG_PACKAGE_libwolfssl is not set
CONFIG_PACKAGE_luci-app-attendedsysupgrade=y
CONFIG_PACKAGE_luci-app-ser2net=y
CONFIG_PACKAGE_luci-i18n-attendedsysupgrade-zh-cn=y
CONFIG_PACKAGE_luci-i18n-base-zh-cn=y
CONFIG_PACKAGE_luci-i18n-firewall-zh-cn=y
CONFIG_PACKAGE_luci-i18n-freeioe-zh-cn=y
CONFIG_PACKAGE_luci-i18n-package-manager-zh-cn=y
CONFIG_PACKAGE_luci-i18n-ser2net-zh-cn=y
CONFIG_PACKAGE_mosquitto-ssl=y
CONFIG_PACKAGE_mt7601u-firmware=y
CONFIG_PACKAGE_r8152-firmware=y
CONFIG_PACKAGE_robot-client=m
CONFIG_PACKAGE_robot-pong=m
CONFIG_PACKAGE_robot-server=m
CONFIG_PACKAGE_robot-web=m
CONFIG_PACKAGE_rpcd-mod-rpcsys=y
CONFIG_PACKAGE_rt2800-usb-firmware=y
CONFIG_PACKAGE_rt73-usb-firmware=y
CONFIG_PACKAGE_rtl8192cu-firmware=y
CONFIG_PACKAGE_rtl8821ce-firmware=y
CONFIG_PACKAGE_siridb-server=y
CONFIG_PACKAGE_speedtestcpp=y
CONFIG_PACKAGE_wpad-basic-mbedtls=y
# CONFIG_PACKAGE_wpad-basic-wolfssl is not set
CONFIG_PACKAGE_yajl=y
CONFIG_PCRE2_JIT_ENABLED=y
CONFIG_SUNXI_SD_BOOT_PARTSIZE=20
CONFIG_TARGET_ROOTFS_PARTSIZE=256
# CONFIG_WOLFSSL_HAS_OPENVPN is not set
# CONFIG_WPA_WOLFSSL is not set
```

## thingslink/tlink_k2x_symlink_defconfig
```kconfig
CONFIG_TARGET_sunxi=y
CONFIG_TARGET_sunxi_cortexa7=y
CONFIG_TARGET_sunxi_cortexa7_DEVICE_kooiot_tlink-k2x=y
CONFIG_GNUTLS_ALPN=y
CONFIG_GNUTLS_ANON=y
CONFIG_GNUTLS_DTLS_SRTP=y
CONFIG_GNUTLS_HEARTBEAT=y
CONFIG_GNUTLS_OCSP=y
CONFIG_GNUTLS_PSK=y
CONFIG_KERNEL_DEBUG_LL=y
CONFIG_KERNEL_DEBUG_LL_UART_NONE=y
CONFIG_KERNEL_DEVTMPFS=y
CONFIG_KERNEL_EARLY_PRINTK=y
CONFIG_KERNEL_IO_URING=y
CONFIG_LCD4LINUX_CUSTOM_DRIVER_FW8888=y
CONFIG_LCD4LINUX_CUSTOM_DRIVER_GLCD2USB=y
CONFIG_LCD4LINUX_CUSTOM_DRIVER_LCD2USB=y
CONFIG_LCD4LINUX_CUSTOM_DRIVER_LEDMatrix=y
CONFIG_LCD4LINUX_CUSTOM_DRIVER_MatrixOrbital=y
CONFIG_LCD4LINUX_CUSTOM_DRIVER_MatrixOrbitalGX=y
CONFIG_LCD4LINUX_CUSTOM_DRIVER_NULL=y
CONFIG_LCD4LINUX_CUSTOM_DRIVER_PNG=y
CONFIG_LCD4LINUX_CUSTOM_DRIVER_USBLCD=y
CONFIG_LCD4LINUX_CUSTOM_NEEDS_libgd=y
CONFIG_LCD4LINUX_CUSTOM_NEEDS_libusb=y
CONFIG_LCD4LINUX_CUSTOM_NEEDS_ppp=y
CONFIG_LCD4LINUX_CUSTOM_PLUGIN_button_exec=y
CONFIG_LCD4LINUX_CUSTOM_PLUGIN_cpuinfo=y
CONFIG_LCD4LINUX_CUSTOM_PLUGIN_diskstats=y
CONFIG_LCD4LINUX_CUSTOM_PLUGIN_event=y
CONFIG_LCD4LINUX_CUSTOM_PLUGIN_exec=y
CONFIG_LCD4LINUX_CUSTOM_PLUGIN_file=y
CONFIG_LCD4LINUX_CUSTOM_PLUGIN_loadavg=y
CONFIG_LCD4LINUX_CUSTOM_PLUGIN_meminfo=y
CONFIG_LCD4LINUX_CUSTOM_PLUGIN_netdev=y
CONFIG_LCD4LINUX_CUSTOM_PLUGIN_netinfo=y
CONFIG_LCD4LINUX_CUSTOM_PLUGIN_ppp=y
CONFIG_LCD4LINUX_CUSTOM_PLUGIN_proc_stat=y
CONFIG_LCD4LINUX_CUSTOM_PLUGIN_statfs=y
CONFIG_LCD4LINUX_CUSTOM_PLUGIN_uname=y
CONFIG_LCD4LINUX_CUSTOM_PLUGIN_uptime=y
# CONFIG_LIBCURL_UNIX_SOCKETS is not set
CONFIG_LUCI_LANG_zh_Hans=y
CONFIG_MOSQUITTO_CTRL=y
CONFIG_MOSQUITTO_DYNAMIC_SECURITY=y
CONFIG_MOSQUITTO_LWS=y
CONFIG_MOSQUITTO_PASSWD=y
# CONFIG_OPENSSL_WITH_IDEA is not set
# CONFIG_OPENSSL_WITH_MDC2 is not set
CONFIG_OPENSSL_WITH_NPN=y
# CONFIG_OPENSSL_WITH_SEED is not set
# CONFIG_OPENSSL_WITH_WHIRLPOOL is not set
CONFIG_PACKAGE_attendedsysupgrade-common=y
CONFIG_PACKAGE_cJSON=y
CONFIG_PACKAGE_factory-tlink=m
# CONFIG_PACKAGE_freeioe is not set
CONFIG_PACKAGE_kmod-backlight=y
CONFIG_PACKAGE_kmod-backlight-pwm=y
CONFIG_PACKAGE_kmod-crypto-sha256=y
CONFIG_PACKAGE_kmod-eeprom-93cx6=y
CONFIG_PACKAGE_kmod-lib-crc-itu-t=y
CONFIG_PACKAGE_kmod-mt7601u=y
CONFIG_PACKAGE_kmod-nf-nat6=y
CONFIG_PACKAGE_kmod-pwm-sun8i=y
CONFIG_PACKAGE_kmod-rt2800-lib=y
CONFIG_PACKAGE_kmod-rt2800-usb=y
CONFIG_PACKAGE_kmod-rt2x00-lib=y
CONFIG_PACKAGE_kmod-rt2x00-usb=y
CONFIG_PACKAGE_kmod-rtc-rx8010=y
CONFIG_PACKAGE_kmod-rtl8192c-common=y
CONFIG_PACKAGE_kmod-rtl8192cu=y
CONFIG_PACKAGE_kmod-rtl8xxxu=y
CONFIG_PACKAGE_kmod-rtlwifi=y
CONFIG_PACKAGE_kmod-rtlwifi-usb=y
CONFIG_PACKAGE_kmod-rtw88=y
CONFIG_PACKAGE_kmod-rtw88-8821c=y
CONFIG_PACKAGE_kmod-rtw88-8821cu=y
CONFIG_PACKAGE_kmod-rtw88-8822c=y
CONFIG_PACKAGE_kmod-rtw88-8822cu=y
CONFIG_PACKAGE_kmod-rtw88-usb=y
CONFIG_PACKAGE_kmod-serial-xr14xx-usb=y
CONFIG_PACKAGE_kmod-spi-bitbang=y
CONFIG_PACKAGE_kmod-usb-net-cdc-eem=y
CONFIG_PACKAGE_kmod-usb-net-cdc-mbim=y
CONFIG_PACKAGE_kmod-usb-net-rtl8150=y
CONFIG_PACKAGE_kmod-usb-net-rtl8152=y
CONFIG_PACKAGE_kmod-usb-otg-sunxi=y
CONFIG_PACKAGE_kmod-usb-serial-ch341=y
CONFIG_PACKAGE_kmod-usb-serial-cp210x=y
CONFIG_PACKAGE_kmod-usb-serial-pl2303=y
CONFIG_PACKAGE_lcd4linux-custom=y
CONFIG_PACKAGE_libcap=y
CONFIG_PACKAGE_libcleri=y
CONFIG_PACKAGE_libgd=y
CONFIG_PACKAGE_libgmp=y
CONFIG_PACKAGE_libgnutls=y
CONFIG_PACKAGE_libiconv-full-full=m
CONFIG_PACKAGE_libiwinfo-lua=y
CONFIG_PACKAGE_libjpeg-turbo=y
CONFIG_PACKAGE_libnettle=y
CONFIG_PACKAGE_libopenssl-v1=y
CONFIG_PACKAGE_libpcap=y
CONFIG_PACKAGE_libpcre2=y
CONFIG_PACKAGE_libpng=y
CONFIG_PACKAGE_libspeedtestcpp=y
CONFIG_PACKAGE_libusb-compat=y
CONFIG_PACKAGE_libuv=y
CONFIG_PACKAGE_libwebp=y
CONFIG_PACKAGE_libwebsockets-full=y
# CONFIG_PACKAGE_libwolfssl is not set
CONFIG_PACKAGE_libzip-gnutls=y
CONFIG_PACKAGE_luci-app-attendedsysupgrade=y
# CONFIG_PACKAGE_luci-app-freeioe is not set
CONFIG_PACKAGE_luci-i18n-attendedsysupgrade-zh-cn=y
CONFIG_PACKAGE_luci-i18n-base-zh-cn=y
CONFIG_PACKAGE_luci-i18n-firewall-zh-cn=y
CONFIG_PACKAGE_luci-i18n-package-manager-zh-cn=y
CONFIG_PACKAGE_luci-i18n-ser2net-zh-cn=y
CONFIG_PACKAGE_mosquitto-ssl=y
CONFIG_PACKAGE_mt7601u-firmware=y
CONFIG_PACKAGE_r8152-firmware=y
CONFIG_PACKAGE_robot-client=m
CONFIG_PACKAGE_robot-pong=m
CONFIG_PACKAGE_robot-server=m
CONFIG_PACKAGE_robot-web=m
CONFIG_PACKAGE_rpcd-mod-rpcsys=y
CONFIG_PACKAGE_rt2800-usb-firmware=y
CONFIG_PACKAGE_rt73-usb-firmware=y
CONFIG_PACKAGE_rtl8188eu-firmware=y
CONFIG_PACKAGE_rtl8188fu-firmware=y
CONFIG_PACKAGE_rtl8192cu-firmware=y
CONFIG_PACKAGE_rtl8192eu-firmware=y
CONFIG_PACKAGE_rtl8723bu-firmware=y
CONFIG_PACKAGE_rtl8821ce-firmware=y
CONFIG_PACKAGE_rtl8822ce-firmware=y
CONFIG_PACKAGE_siridb-server=y
# CONFIG_PACKAGE_skynet is not set
CONFIG_PACKAGE_speedtestcpp=y
CONFIG_PACKAGE_symlink-openssl-v1=y
CONFIG_PACKAGE_symlink-psn=y
CONFIG_PACKAGE_tcpdump=y
CONFIG_PACKAGE_tlink-usb2lcd=y
CONFIG_PACKAGE_wpad-basic-mbedtls=y
# CONFIG_PACKAGE_wpad-basic-wolfssl is not set
CONFIG_PACKAGE_yajl=y
CONFIG_PCRE2_JIT_ENABLED=y
CONFIG_SUNXI_SD_BOOT_PARTSIZE=20
CONFIG_TARGET_ROOTFS_PARTSIZE=256
# CONFIG_WOLFSSL_HAS_OPENVPN is not set
# CONFIG_WPA_WOLFSSL is not set
CONFIG_OPENSSL_ENGINE_BUILTIN=y
# CONFIG_OPENSSL_ENGINE_BUILTIN_AFALG is not set
# CONFIG_OPENSSL_ENGINE_BUILTIN_DEVCRYPTO is not set
CONFIG_OPENSSL_WITH_SM234=y
CONFIG_PACKAGE_liblucihttp-lua=y
CONFIG_PACKAGE_libubus-lua=y
CONFIG_PACKAGE_lua=y
# CONFIG_PACKAGE_lua-examples is not set
CONFIG_PACKAGE_luci-lib-base=y
CONFIG_PACKAGE_luci-lib-ip=y
CONFIG_PACKAGE_luci-lib-jsonc=y
CONFIG_PACKAGE_luci-lib-nixio=y
CONFIG_PACKAGE_luci-lua-runtime=y
CONFIG_PACKAGE_process-monitor=y
CONFIG_PACKAGE_ucode-mod-lua=y
```

## thingslink/tlink_k4a_defconfig
```kconfig
CONFIG_TARGET_sunxi=y
CONFIG_TARGET_sunxi_cortexa7=y
CONFIG_TARGET_sunxi_cortexa7_DEVICE_kooiot_tlink-k4a=y
# CONFIG_KERNEL_NET_L3_MASTER_DEV is not set
CONFIG_KERNEL_PAGE_POOL=y
CONFIG_LCD4LINUX_CUSTOM_DRIVER_FW8888=y
CONFIG_LCD4LINUX_CUSTOM_DRIVER_GLCD2USB=y
CONFIG_LCD4LINUX_CUSTOM_DRIVER_LCD2USB=y
CONFIG_LCD4LINUX_CUSTOM_DRIVER_LEDMatrix=y
CONFIG_LCD4LINUX_CUSTOM_DRIVER_MatrixOrbital=y
CONFIG_LCD4LINUX_CUSTOM_DRIVER_MatrixOrbitalGX=y
CONFIG_LCD4LINUX_CUSTOM_DRIVER_NULL=y
CONFIG_LCD4LINUX_CUSTOM_DRIVER_PNG=y
CONFIG_LCD4LINUX_CUSTOM_DRIVER_USBLCD=y
CONFIG_LCD4LINUX_CUSTOM_NEEDS_libgd=y
CONFIG_LCD4LINUX_CUSTOM_NEEDS_libusb=y
CONFIG_LCD4LINUX_CUSTOM_NEEDS_ppp=y
CONFIG_LCD4LINUX_CUSTOM_PLUGIN_button_exec=y
CONFIG_LCD4LINUX_CUSTOM_PLUGIN_cpuinfo=y
CONFIG_LCD4LINUX_CUSTOM_PLUGIN_diskstats=y
CONFIG_LCD4LINUX_CUSTOM_PLUGIN_event=y
CONFIG_LCD4LINUX_CUSTOM_PLUGIN_exec=y
CONFIG_LCD4LINUX_CUSTOM_PLUGIN_file=y
CONFIG_LCD4LINUX_CUSTOM_PLUGIN_loadavg=y
CONFIG_LCD4LINUX_CUSTOM_PLUGIN_meminfo=y
CONFIG_LCD4LINUX_CUSTOM_PLUGIN_netdev=y
CONFIG_LCD4LINUX_CUSTOM_PLUGIN_netinfo=y
CONFIG_LCD4LINUX_CUSTOM_PLUGIN_ppp=y
CONFIG_LCD4LINUX_CUSTOM_PLUGIN_proc_stat=y
CONFIG_LCD4LINUX_CUSTOM_PLUGIN_statfs=y
CONFIG_LCD4LINUX_CUSTOM_PLUGIN_uname=y
CONFIG_LCD4LINUX_CUSTOM_PLUGIN_uptime=y
CONFIG_LUCI_LANG_zh_Hans=y
CONFIG_PACKAGE_kmod-mt76-core=y
CONFIG_PACKAGE_kmod-mt76-usb=y
CONFIG_PACKAGE_kmod-mt76x0-common=y
CONFIG_PACKAGE_kmod-mt76x02-common=y
CONFIG_PACKAGE_kmod-mt76x02-usb=y
CONFIG_PACKAGE_kmod-mt76x0u=y
CONFIG_PACKAGE_kmod-mt76x2-common=y
CONFIG_PACKAGE_kmod-mt76x2u=y
CONFIG_PACKAGE_kmod-rtl8192c-common=y
CONFIG_PACKAGE_kmod-rtl8192cu=y
CONFIG_PACKAGE_kmod-rtlwifi=y
CONFIG_PACKAGE_kmod-rtlwifi-usb=y
CONFIG_PACKAGE_lcd4linux-custom=y
CONFIG_PACKAGE_libcleri=y
CONFIG_PACKAGE_libgd=y
CONFIG_PACKAGE_libjpeg-turbo=y
CONFIG_PACKAGE_libpcre2=y
CONFIG_PACKAGE_libpng=y
CONFIG_PACKAGE_libusb-compat=y
CONFIG_PACKAGE_libuv=y
CONFIG_PACKAGE_libwebp=y
CONFIG_PACKAGE_luci-app-ser2net=y
CONFIG_PACKAGE_luci-i18n-base-zh-cn=y
CONFIG_PACKAGE_luci-i18n-firewall-zh-cn=y
CONFIG_PACKAGE_luci-i18n-freeioe-zh-cn=y
CONFIG_PACKAGE_luci-i18n-package-manager-zh-cn=y
CONFIG_PACKAGE_luci-i18n-ser2net-zh-cn=y
CONFIG_PACKAGE_rtl8192cu-firmware=y
CONFIG_PACKAGE_siridb-server=y
CONFIG_PACKAGE_tlink-usb2lcd=y
CONFIG_PACKAGE_yajl=y
CONFIG_PCRE2_JIT_ENABLED=y
CONFIG_SUNXI_SD_BOOT_PARTSIZE=20
CONFIG_TARGET_KERNEL_PARTSIZE=20
CONFIG_TARGET_ROOTFS_PARTSIZE=256
```

## thingslink/tlink_k4a_symlink_defconfig
```kconfig
CONFIG_TARGET_sunxi=y
CONFIG_TARGET_sunxi_cortexa7=y
CONFIG_TARGET_sunxi_cortexa7_DEVICE_kooiot_tlink-k4a=y
CONFIG_LUCI_LANG_zh_Hans=y
CONFIG_PACKAGE_bacnet-stack-router=y
CONFIG_PACKAGE_bacnet-stack-server=y
# CONFIG_PACKAGE_freeioe is not set
CONFIG_PACKAGE_kmod-usb-net-ipheth=y
CONFIG_PACKAGE_kmod-usb-net-rndis=y
CONFIG_PACKAGE_libcap=y
CONFIG_PACKAGE_libconfig=y
CONFIG_PACKAGE_libimobiledevice=y
CONFIG_PACKAGE_libimobiledevice-glue=y
CONFIG_PACKAGE_libopenssl-v1=y
CONFIG_PACKAGE_libplist=y
CONFIG_PACKAGE_libusbmuxd=y
CONFIG_PACKAGE_libuv=y
CONFIG_PACKAGE_libwebsockets-full=y
CONFIG_PACKAGE_libxml2=y
CONFIG_PACKAGE_luci-app-bacrouter=y
CONFIG_PACKAGE_luci-app-bacserver=y
# CONFIG_PACKAGE_luci-app-freeioe is not set
CONFIG_PACKAGE_luci-i18n-base-zh-cn=y
CONFIG_PACKAGE_luci-i18n-firewall-zh-cn=y
CONFIG_PACKAGE_luci-i18n-package-manager-zh-cn=y
CONFIG_PACKAGE_luci-i18n-ser2net-zh-cn=y
CONFIG_PACKAGE_phone-usb-tether=y
# CONFIG_PACKAGE_skynet is not set
CONFIG_PACKAGE_symlink-openssl-v1=y
CONFIG_PACKAGE_symlink-psn=y
CONFIG_PACKAGE_usbmuxd=y
# CONFIG_SUN8I_V3S_SPINAND_OPTIONS is not set
CONFIG_SUNXI_SD_BOOT_PARTSIZE=20
CONFIG_TARGET_KERNEL_PARTSIZE=20
CONFIG_TARGET_ROOTFS_PARTSIZE=256
CONFIG_OPENSSL_ENGINE_BUILTIN=y
# CONFIG_OPENSSL_ENGINE_BUILTIN_AFALG is not set
# CONFIG_OPENSSL_ENGINE_BUILTIN_DEVCRYPTO is not set
CONFIG_OPENSSL_WITH_SM234=y
CONFIG_PACKAGE_liblua=y
CONFIG_PACKAGE_liblucihttp-lua=y
CONFIG_PACKAGE_libubus-lua=y
CONFIG_PACKAGE_lua=y
# CONFIG_PACKAGE_lua-examples is not set
CONFIG_PACKAGE_luci-lib-base=y
CONFIG_PACKAGE_luci-lib-ip=y
CONFIG_PACKAGE_luci-lib-jsonc=y
CONFIG_PACKAGE_luci-lib-nixio=y
CONFIG_PACKAGE_luci-lua-runtime=y
CONFIG_PACKAGE_process-monitor=y
CONFIG_PACKAGE_ucode-mod-lua=y
```

## thingslink/tlink_k4g_defconfig
```kconfig
CONFIG_TARGET_sunxi=y
CONFIG_TARGET_sunxi_cortexa7=y
CONFIG_TARGET_sunxi_cortexa7_DEVICE_kooiot_tlink-k4g=y
CONFIG_LCD4LINUX_CUSTOM_DRIVER_FW8888=y
CONFIG_LCD4LINUX_CUSTOM_DRIVER_GLCD2USB=y
CONFIG_LCD4LINUX_CUSTOM_DRIVER_LCD2USB=y
CONFIG_LCD4LINUX_CUSTOM_DRIVER_LEDMatrix=y
CONFIG_LCD4LINUX_CUSTOM_DRIVER_MatrixOrbital=y
CONFIG_LCD4LINUX_CUSTOM_DRIVER_MatrixOrbitalGX=y
CONFIG_LCD4LINUX_CUSTOM_DRIVER_NULL=y
CONFIG_LCD4LINUX_CUSTOM_DRIVER_PNG=y
CONFIG_LCD4LINUX_CUSTOM_DRIVER_USBLCD=y
CONFIG_LCD4LINUX_CUSTOM_NEEDS_libgd=y
CONFIG_LCD4LINUX_CUSTOM_NEEDS_libusb=y
CONFIG_LCD4LINUX_CUSTOM_NEEDS_ppp=y
CONFIG_LCD4LINUX_CUSTOM_PLUGIN_button_exec=y
CONFIG_LCD4LINUX_CUSTOM_PLUGIN_cpuinfo=y
CONFIG_LCD4LINUX_CUSTOM_PLUGIN_diskstats=y
CONFIG_LCD4LINUX_CUSTOM_PLUGIN_event=y
CONFIG_LCD4LINUX_CUSTOM_PLUGIN_exec=y
CONFIG_LCD4LINUX_CUSTOM_PLUGIN_file=y
CONFIG_LCD4LINUX_CUSTOM_PLUGIN_loadavg=y
CONFIG_LCD4LINUX_CUSTOM_PLUGIN_meminfo=y
CONFIG_LCD4LINUX_CUSTOM_PLUGIN_netdev=y
CONFIG_LCD4LINUX_CUSTOM_PLUGIN_netinfo=y
CONFIG_LCD4LINUX_CUSTOM_PLUGIN_ppp=y
CONFIG_LCD4LINUX_CUSTOM_PLUGIN_proc_stat=y
CONFIG_LCD4LINUX_CUSTOM_PLUGIN_statfs=y
CONFIG_LCD4LINUX_CUSTOM_PLUGIN_uname=y
CONFIG_LCD4LINUX_CUSTOM_PLUGIN_uptime=y
CONFIG_LUCI_LANG_zh_Hans=y
CONFIG_PACKAGE_bacnet-stack-router=y
CONFIG_PACKAGE_bacnet-stack-server=y
CONFIG_PACKAGE_kmod-usb-net-ipheth=y
CONFIG_PACKAGE_kmod-usb-net-rndis=y
CONFIG_PACKAGE_lcd4linux-custom=y
CONFIG_PACKAGE_libcap=y
CONFIG_PACKAGE_libconfig=y
CONFIG_PACKAGE_libgd=y
CONFIG_PACKAGE_libimobiledevice=y
CONFIG_PACKAGE_libimobiledevice-glue=y
CONFIG_PACKAGE_libjpeg-turbo=y
CONFIG_PACKAGE_libopenssl-v1=y
CONFIG_PACKAGE_libplist=y
CONFIG_PACKAGE_libpng=y
CONFIG_PACKAGE_libusb-compat=y
CONFIG_PACKAGE_libusbmuxd=y
CONFIG_PACKAGE_libuv=y
CONFIG_PACKAGE_libwebp=y
CONFIG_PACKAGE_libwebsockets-full=y
CONFIG_PACKAGE_libxml2=y
CONFIG_PACKAGE_luci-app-bacrouter=y
CONFIG_PACKAGE_luci-app-bacserver=y
CONFIG_PACKAGE_luci-i18n-base-zh-cn=y
CONFIG_PACKAGE_luci-i18n-firewall-zh-cn=y
CONFIG_PACKAGE_luci-i18n-freeioe-zh-cn=y
CONFIG_PACKAGE_luci-i18n-package-manager-zh-cn=y
CONFIG_PACKAGE_luci-i18n-ser2net-zh-cn=y
CONFIG_PACKAGE_phone-usb-tether=y
CONFIG_PACKAGE_tlink-usb2lcd=y
CONFIG_PACKAGE_usbmuxd=y
# CONFIG_SUN8I_V3S_SPINAND_OPTIONS is not set
CONFIG_SUNXI_SD_BOOT_PARTSIZE=20
CONFIG_TARGET_KERNEL_PARTSIZE=20
CONFIG_TARGET_ROOTFS_PARTSIZE=256
```
