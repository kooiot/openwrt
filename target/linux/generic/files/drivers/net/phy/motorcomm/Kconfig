## thingslink/tlink_c35_defconfig
```kconfig
CONFIG_TARGET_ramips=y
CONFIG_TARGET_ramips_mt76x8=y
CONFIG_TARGET_ramips_mt76x8_DEVICE_kooiot_tlink-c35-32m=y
CONFIG_GENSIO_PTHREADS=y
CONFIG_KERNEL_IO_URING=y
# CONFIG_LIBCURL_UNIX_SOCKETS is not set
CONFIG_LUCI_LANG_zh_Hans=y
# CONFIG_OPENSSL_WITH_IDEA is not set
# CONFIG_OPENSSL_WITH_MDC2 is not set
# CONFIG_OPENSSL_WITH_SEED is not set
# CONFIG_OPENSSL_WITH_WHIRLPOOL is not set
CONFIG_PACKAGE_kmod-crypto-sha256=y
CONFIG_PACKAGE_kmod-nf-nat6=y
CONFIG_PACKAGE_libgensio=y
CONFIG_PACKAGE_libiwinfo-lua=y
CONFIG_PACKAGE_libyaml=y
CONFIG_PACKAGE_luci-app-ser2net=y
CONFIG_PACKAGE_luci-i18n-base-zh-cn=y
CONFIG_PACKAGE_luci-i18n-firewall-zh-cn=y
CONFIG_PACKAGE_luci-i18n-freeioe-zh-cn=y
CONFIG_PACKAGE_luci-i18n-opkg-zh-cn=y
CONFIG_PACKAGE_luci-i18n-ser2net-zh-cn=y
CONFIG_PACKAGE_ser2net=y
# CONFIG_WOLFSSL_HAS_OPENVPN is not set
```

## thingslink/tlink_c4_32m_defconfig
```kconfig
CONFIG_TARGET_ramips=y
CONFIG_TARGET_ramips_mt76x8=y
CONFIG_TARGET_ramips_mt76x8_DEVICE_kooiot_tlink-c4-32m=y
CONFIG_LUCI_LANG_zh_Hans=y
CONFIG_PACKAGE_libinih=y
CONFIG_PACKAGE_luci-i18n-base-zh-cn=y
CONFIG_PACKAGE_luci-i18n-firewall-zh-cn=y
CONFIG_PACKAGE_luci-i18n-freeioe-zh-cn=y
CONFIG_PACKAGE_luci-i18n-opkg-zh-cn=y
CONFIG_PACKAGE_tio=y
```

## thingslink/tlink_dly_e204_defconfig
```kconfig
CONFIG_TARGET_sunxi=y
CONFIG_TARGET_sunxi_cortexa7=y
CONFIG_TARGET_sunxi_cortexa7_DEVICE_kooiot_tlink-dly-e204=y
# CONFIG_KERNEL_WERROR is not set
CONFIG_LCD4LINUX_CUSTOM_DRIVER_FW8888=y
CONFIG_LCD4LINUX_CUSTOM_DRIVER_GLCD2USB=y
CONFIG_LCD4LINUX_CUSTOM_DRIVER_LCD2USB=y
CONFIG_LCD4LINUX_CUSTOM_DRIVER_LEDMatrix=y
CONFIG_LCD4LINUX_CUSTOM_DRIVER_MatrixOrbital=y
CONFIG_LCD4LINUX_CUSTOM_DRIVER_MatrixOrbitalGX=y
CONFIG_LCD4LINUX_CUSTOM_DRIVER_NULL=y
CONFIG_LCD4LINUX_CUSTOM_DRIVER_PNG=y
CONFIG_LCD4LINUX_CUSTOM_DRIVER_USBLCD=y
CONFIG_LCD4LINUX_CUSTOM_NEEDS_libgd=y
CONFIG_LCD4LINUX_CUSTOM_NEEDS_libusb=y
CONFIG_LCD4LINUX_CUSTOM_NEEDS_ppp=y
CONFIG_LCD4LINUX_CUSTOM_PLUGIN_button_exec=y
CONFIG_LCD4LINUX_CUSTOM_PLUGIN_cpuinfo=y
CONFIG_LCD4LINUX_CUSTOM_PLUGIN_diskstats=y
CONFIG_LCD4LINUX_CUSTOM_PLUGIN_event=y
CONFIG_LCD4LINUX_CUSTOM_PLUGIN_exec=y
CONFIG_LCD4LINUX_CUSTOM_PLUGIN_file=y
CONFIG_LCD4LINUX_CUSTOM_PLUGIN_loadavg=y
CONFIG_LCD4LINUX_CUSTOM_PLUGIN_meminfo=y
CONFIG_LCD4LINUX_CUSTOM_PLUGIN_netdev=y
CONFIG_LCD4LINUX_CUSTOM_PLUGIN_netinfo=y
CONFIG_LCD4LINUX_CUSTOM_PLUGIN_ppp=y
CONFIG_LCD4LINUX_CUSTOM_PLUGIN_proc_stat=y
CONFIG_LCD4LINUX_CUSTOM_PLUGIN_statfs=y
CONFIG_LCD4LINUX_CUSTOM_PLUGIN_uname=y
CONFIG_LCD4LINUX_CUSTOM_PLUGIN_uptime=y
CONFIG_LUCI_LANG_zh_Hans=y
CONFIG_PACKAGE_MAC80211_DEBUGFS=y
CONFIG_PACKAGE_MAC80211_MESH=y
CONFIG_PACKAGE_iw=y
CONFIG_PACKAGE_kmod-can=y
CONFIG_PACKAGE_kmod-can-bcm=y
CONFIG_PACKAGE_kmod-can-raw=y
CONFIG_PACKAGE_kmod-can-sunxi=y
CONFIG_PACKAGE_kmod-cfg80211=y
CONFIG_PACKAGE_kmod-crypto-aead=y
CONFIG_PACKAGE_kmod-crypto-ccm=y
CONFIG_PACKAGE_kmod-crypto-cmac=y
CONFIG_PACKAGE_kmod-crypto-ctr=y
CONFIG_PACKAGE_kmod-crypto-gcm=y
CONFIG_PACKAGE_kmod-crypto-geniv=y
CONFIG_PACKAGE_kmod-crypto-gf128=y
CONFIG_PACKAGE_kmod-crypto-ghash=y
CONFIG_PACKAGE_kmod-crypto-hmac=y
CONFIG_PACKAGE_kmod-crypto-manager=y
CONFIG_PACKAGE_kmod-crypto-null=y
CONFIG_PACKAGE_kmod-crypto-rng=y
CONFIG_PACKAGE_kmod-crypto-seqiv=y
CONFIG_PACKAGE_kmod-crypto-sha3=y
CONFIG_PACKAGE_kmod-crypto-sha512=y
CONFIG_PACKAGE_kmod-eeprom-at24=y
CONFIG_PACKAGE_kmod-mac80211=y
CONFIG_PACKAGE_kmod-regmap-core=y
CONFIG_PACKAGE_kmod-regmap-i2c=y
# CONFIG_PACKAGE_kmod-rtc-isl1208 is not set
CONFIG_PACKAGE_kmod-rtc-sd3078=y
CONFIG_PACKAGE_kmod-rtl8xxxu=y
CONFIG_PACKAGE_lcd4linux-custom=y
CONFIG_PACKAGE_libgd=y
CONFIG_PACKAGE_libinih=y
CONFIG_PACKAGE_libjpeg-turbo=y
CONFIG_PACKAGE_libopenssl-v1=y
CONFIG_PACKAGE_libpng=y
CONFIG_PACKAGE_libusb-compat=y
CONFIG_PACKAGE_libwebp=y
CONFIG_PACKAGE_luci-i18n-base-zh-cn=y
CONFIG_PACKAGE_luci-i18n-firewall-zh-cn=y
CONFIG_PACKAGE_luci-i18n-freeioe-zh-cn=y
CONFIG_PACKAGE_luci-i18n-opkg-zh-cn=y
CONFIG_PACKAGE_minicom=y
CONFIG_PACKAGE_rtl8723bu-firmware=y
CONFIG_PACKAGE_tio=y
CONFIG_PACKAGE_tlink-usb2lcd=y
CONFIG_PACKAGE_wifi-scripts=y
CONFIG_PACKAGE_wireless-regdb=y
CONFIG_SUNXI_SD_BOOT_PARTSIZE=20
CONFIG_TARGET_ROOTFS_PARTSIZE=256
# CONFIG_WPA_MBO_SUPPORT is not set
```

## thingslink/tlink_e1_defconfig
```kconfig
CONFIG_TARGET_sunxi=y
CONFIG_TARGET_sunxi_cortexa7=y
CONFIG_TARGET_sunxi_cortexa7_DEVICE_kooiot_tlink-e1=y
# CONFIG_KERNEL_WERROR is not set
CONFIG_LUCI_LANG_zh_Hans=y
CONFIG_PACKAGE_MAC80211_DEBUGFS=y
CONFIG_PACKAGE_MAC80211_MESH=y
CONFIG_PACKAGE_canutils=y
CONFIG_PACKAGE_canutils-candump=y
CONFIG_PACKAGE_canutils-cansend=y
CONFIG_PACKAGE_iw=y
CONFIG_PACKAGE_kmod-can=y
CONFIG_PACKAGE_kmod-can-bcm=y
CONFIG_PACKAGE_kmod-can-raw=y
CONFIG_PACKAGE_kmod-can-sunxi=y
CONFIG_PACKAGE_kmod-cfg80211=y
CONFIG_PACKAGE_kmod-crypto-aead=y
CONFIG_PACKAGE_kmod-crypto-ccm=y
CONFIG_PACKAGE_kmod-crypto-cmac=y
CONFIG_PACKAGE_kmod-crypto-ctr=y
CONFIG_PACKAGE_kmod-crypto-gcm=y
CONFIG_PACKAGE_kmod-crypto-geniv=y
CONFIG_PACKAGE_kmod-crypto-gf128=y
CONFIG_PACKAGE_kmod-crypto-ghash=y
CONFIG_PACKAGE_kmod-crypto-hmac=y
CONFIG_PACKAGE_kmod-crypto-manager=y
CONFIG_PACKAGE_kmod-crypto-null=y
CONFIG_PACKAGE_kmod-crypto-rng=y
CONFIG_PACKAGE_kmod-crypto-seqiv=y
CONFIG_PACKAGE_kmod-crypto-sha3=y
CONFIG_PACKAGE_kmod-crypto-sha512=y
CONFIG_PACKAGE_kmod-eeprom-at24=y
CONFIG_PACKAGE_kmod-i2c-core=y
CONFIG_PACKAGE_kmod-libphy=y
CONFIG_PACKAGE_kmod-mac80211=y
CONFIG_PACKAGE_kmod-mdio-devres=y
CONFIG_PACKAGE_kmod-net-selftests=y
CONFIG_PACKAGE_kmod-phy-ax88796b=y
CONFIG_PACKAGE_kmod-phylink=y
CONFIG_PACKAGE_kmod-regmap-core=y
CONFIG_PACKAGE_kmod-regmap-i2c=y
CONFIG_PACKAGE_kmod-rtc-sd3078=y
CONFIG_PACKAGE_kmod-rtl8xxxu=y
CONFIG_PACKAGE_kmod-usb-net-asix=y
CONFIG_PACKAGE_luci-i18n-base-zh-cn=y
CONFIG_PACKAGE_luci-i18n-firewall-zh-cn=y
CONFIG_PACKAGE_luci-i18n-freeioe-zh-cn=y
CONFIG_PACKAGE_luci-i18n-opkg-zh-cn=y
CONFIG_PACKAGE_rtl8723bu-firmware=y
CONFIG_PACKAGE_wifi-scripts=y
CONFIG_PACKAGE_wireless-regdb=y
CONFIG_SUNXI_SD_BOOT_PARTSIZE=20
CONFIG_TARGET_ROOTFS_PARTSIZE=256
# CONFIG_WPA_MBO_SUPPORT is not set
```

## thingslink/tlink_e1_symlink_defconfig
```kconfig
CONFIG_TARGET_sunxi=y
CONFIG_TARGET_sunxi_cortexa7=y
CONFIG_TARGET_sunxi_cortexa7_DEVICE_kooiot_tlink-e1=y
# CONFIG_KERNEL_WERROR is not set
CONFIG_LCD4LINUX_CUSTOM_DRIVER_FW8888=y
CONFIG_LCD4LINUX_CUSTOM_DRIVER_GLCD2USB=y
CONFIG_LCD4LINUX_CUSTOM_DRIVER_LCD2USB=y
CONFIG_LCD4LINUX_CUSTOM_DRIVER_LEDMatrix=y
CONFIG_LCD4LINUX_CUSTOM_DRIVER_MatrixOrbital=y
CONFIG_LCD4LINUX_CUSTOM_DRIVER_MatrixOrbitalGX=y
CONFIG_LCD4LINUX_CUSTOM_DRIVER_NULL=y
CONFIG_LCD4LINUX_CUSTOM_DRIVER_PNG=y
CONFIG_LCD4LINUX_CUSTOM_DRIVER_USBLCD=y
CONFIG_LCD4LINUX_CUSTOM_NEEDS_libgd=y
CONFIG_LCD4LINUX_CUSTOM_NEEDS_libusb=y
CONFIG_LCD4LINUX_CUSTOM_NEEDS_ppp=y
CONFIG_LCD4LINUX_CUSTOM_PLUGIN_button_exec=y
CONFIG_LCD4LINUX_CUSTOM_PLUGIN_cpuinfo=y
CONFIG_LCD4LINUX_CUSTOM_PLUGIN_diskstats=y
CONFIG_LCD4LINUX_CUSTOM_PLUGIN_event=y
CONFIG_LCD4LINUX_CUSTOM_PLUGIN_exec=y
CONFIG_LCD4LINUX_CUSTOM_PLUGIN_file=y
CONFIG_LCD4LINUX_CUSTOM_PLUGIN_loadavg=y
CONFIG_LCD4LINUX_CUSTOM_PLUGIN_meminfo=y
CONFIG_LCD4LINUX_CUSTOM_PLUGIN_netdev=y
CONFIG_LCD4LINUX_CUSTOM_PLUGIN_netinfo=y
CONFIG_LCD4LINUX_CUSTOM_PLUGIN_ppp=y
CONFIG_LCD4LINUX_CUSTOM_PLUGIN_proc_stat=y
CONFIG_LCD4LINUX_CUSTOM_PLUGIN_statfs=y
CONFIG_LCD4LINUX_CUSTOM_PLUGIN_uname=y
CONFIG_LCD4LINUX_CUSTOM_PLUGIN_uptime=y
CONFIG_LUCI_LANG_zh_Hans=y
CONFIG_PACKAGE_MAC80211_DEBUGFS=y
CONFIG_PACKAGE_MAC80211_MESH=y
# CONFIG_PACKAGE_freeioe is not set
CONFIG_PACKAGE_iw=y
CONFIG_PACKAGE_kmod-can=y
CONFIG_PACKAGE_kmod-can-bcm=y
CONFIG_PACKAGE_kmod-can-raw=y
CONFIG_PACKAGE_kmod-can-sunxi=y
CONFIG_PACKAGE_kmod-cfg80211=y
CONFIG_PACKAGE_kmod-crypto-aead=y
CONFIG_PACKAGE_kmod-crypto-ccm=y
CONFIG_PACKAGE_kmod-crypto-cmac=y
CONFIG_PACKAGE_kmod-crypto-ctr=y
CONFIG_PACKAGE_kmod-crypto-gcm=y
CONFIG_PACKAGE_kmod-crypto-geniv=y
CONFIG_PACKAGE_kmod-crypto-gf128=y
CONFIG_PACKAGE_kmod-crypto-ghash=y
CONFIG_PACKAGE_kmod-crypto-hmac=y
CONFIG_PACKAGE_kmod-crypto-manager=y
CONFIG_PACKAGE_kmod-crypto-null=y
CONFIG_PACKAGE_kmod-crypto-rng=y
CONFIG_PACKAGE_kmod-crypto-seqiv=y
CONFIG_PACKAGE_kmod-crypto-sha3=y
CONFIG_PACKAGE_kmod-crypto-sha512=y
CONFIG_PACKAGE_kmod-eeprom-at24=y
CONFIG_PACKAGE_kmod-i2c-core=y
CONFIG_PACKAGE_kmod-libphy=y
CONFIG_PACKAGE_kmod-mac80211=y
CONFIG_PACKAGE_kmod-mdio-devres=y
CONFIG_PACKAGE_kmod-net-selftests=y
CONFIG_PACKAGE_kmod-phy-ax88796b=y
CONFIG_PACKAGE_kmod-phylink=y
CONFIG_PACKAGE_kmod-regmap-core=y
CONFIG_PACKAGE_kmod-regmap-i2c=y
CONFIG_PACKAGE_kmod-rtc-sd3078=y
CONFIG_PACKAGE_kmod-rtl8xxxu=y
CONFIG_PACKAGE_kmod-usb-net-asix=y
CONFIG_PACKAGE_lcd4linux-custom=y
CONFIG_PACKAGE_libgd=y
CONFIG_PACKAGE_libjpeg-turbo=y
CONFIG_PACKAGE_libopenssl-v1=y
CONFIG_PACKAGE_libpng=y
CONFIG_PACKAGE_libusb-compat=y
CONFIG_PACKAGE_libwebp=y
# CONFIG_PACKAGE_luci-app-freeioe is not set
CONFIG_PACKAGE_luci-i18n-attendedsysupgrade-zh-cn=y
CONFIG_PACKAGE_luci-i18n-base-zh-cn=y
CONFIG_PACKAGE_luci-i18n-firewall-zh-cn=y
CONFIG_PACKAGE_luci-i18n-package-manager-zh-cn=y
CONFIG_PACKAGE_luci-i18n-ser2net-zh-cn=y
CONFIG_PACKAGE_rtl8723bu-firmware=y
# CONFIG_PACKAGE_skynet is not set
CONFIG_PACKAGE_symlink-openssl-v1=y
CONFIG_PACKAGE_symlink-psn=y
CONFIG_PACKAGE_tlink-usb2lcd=y
CONFIG_PACKAGE_ucode-mod-digest=y
CONFIG_PACKAGE_wifi-scripts=y
CONFIG_PACKAGE_wireless-regdb=y
CONFIG_SUNXI_SD_BOOT_PARTSIZE=20
CONFIG_TARGET_ROOTFS_PARTSIZE=256
# CONFIG_WPA_MBO_SUPPORT is not set
CONFIG_OPENSSL_ENGINE_BUILTIN=y
# CONFIG_OPENSSL_ENGINE_BUILTIN_AFALG is not set
# CONFIG_OPENSSL_ENGINE_BUILTIN_DEVCRYPTO is not set
CONFIG_OPENSSL_WITH_SM234=y
CONFIG_PACKAGE_liblua=y
CONFIG_PACKAGE_liblucihttp-lua=y
CONFIG_PACKAGE_libubus-lua=y
CONFIG_PACKAGE_lua=y
# CONFIG_PACKAGE_lua-examples is not set
CONFIG_PACKAGE_luci-lib-base=y
CONFIG_PACKAGE_luci-lib-ip=y
CONFIG_PACKAGE_luci-lib-jsonc=y
CONFIG_PACKAGE_luci-lib-nixio=y
CONFIG_PACKAGE_luci-lua-runtime=y
CONFIG_PACKAGE_process-monitor=y
CONFIG_PACKAGE_ucode-mod-lua=y
```

## thingslink/tlink_k2_defconfig
```kconfig
CONFIG_TARGET_sunxi=y
CONFIG_TARGET_sunxi_cortexa7=y
CONFIG_TARGET_sunxi_cortexa7_DEVICE_kooiot_tlink-k2=y
CONFIG_KERNEL_DEVTMPFS=y
CONFIG_KERNEL_IO_URING=y
# CONFIG_LIBCURL_UNIX_SOCKETS is not set
CONFIG_LUCI_LANG_zh_Hans=y
CONFIG_MOSQUITTO_CTRL=y
CONFIG_MOSQUITTO_DYNAMIC_SECURITY=y
CONFIG_MOSQUITTO_LWS=y
CONFIG_MOSQUITTO_PASSWD=y
# CONFIG_OPENSSL_WITH_IDEA is not set
# CONFIG_OPENSSL_WITH_MDC2 is not set
# CONFIG_OPENSSL_WITH_SEED is not set
# CONFIG_OPENSSL_WITH_WHIRLPOOL is not set
CONFIG_PACKAGE_cJSON=m
CONFIG_PACKAGE_factory-tlink=m
CONFIG_PACKAGE_focas-ubus=m
CONFIG_PACKAGE_kmod-ac97=y
CONFIG_PACKAGE_kmod-backlight=y
CONFIG_PACKAGE_kmod-backlight-pwm=y
CONFIG_PACKAGE_kmod-crypto-sha256=y
CONFIG_PACKAGE_kmod-dma-buf=y
CONFIG_PACKAGE_kmod-drm=y
CONFIG_PACKAGE_kmod-drm-kms-helper=y
CONFIG_PACKAGE_kmod-drm-sun8i=y
CONFIG_PACKAGE_kmod-drm-sun8i-dsi=y
CONFIG_PACKAGE_kmod-drm-sun8i-hdmi=y
CONFIG_PACKAGE_kmod-drm-ttm=y
CONFIG_PACKAGE_kmod-eeprom-93cx6=y
CONFIG_PACKAGE_kmod-fb=y
CONFIG_PACKAGE_kmod-fb-cfb-copyarea=y
CONFIG_PACKAGE_kmod-fb-cfb-fillrect=y
CONFIG_PACKAGE_kmod-fb-cfb-imgblt=y
CONFIG_PACKAGE_kmod-fb-sys-fops=y
CONFIG_PACKAGE_kmod-fb-sys-ram=y
CONFIG_PACKAGE_kmod-hwmon-core=y
CONFIG_PACKAGE_kmod-input-core=y
CONFIG_PACKAGE_kmod-input-evdev=y
CONFIG_PACKAGE_kmod-input-touchscreen-ads7846=y
CONFIG_PACKAGE_kmod-input-touchscreen-goodix=y
CONFIG_PACKAGE_kmod-lib-crc-itu-t=y
CONFIG_PACKAGE_kmod-motorcomm-yt8512c=y
CONFIG_PACKAGE_kmod-motorcomm-yt8521s=y
CONFIG_PACKAGE_kmod-mt7601u=y
CONFIG_PACKAGE_kmod-nf-nat6=y
CONFIG_PACKAGE_kmod-pwm-sun8i=y
CONFIG_PACKAGE_kmod-rt2800-lib=y
CONFIG_PACKAGE_kmod-rt2800-usb=y
CONFIG_PACKAGE_kmod-rt2x00-lib=y
CONFIG_PACKAGE_kmod-rt2x00-usb=y
CONFIG_PACKAGE_kmod-rtc-rx8010=y
CONFIG_PACKAGE_kmod-rtl8192c-common=y
CONFIG_PACKAGE_kmod-rtl8192cu=y
CONFIG_PACKAGE_kmod-rtl8xxxu=y
CONFIG_PACKAGE_kmod-rtlwifi=y
CONFIG_PACKAGE_kmod-rtlwifi-usb=y
CONFIG_PACKAGE_kmod-sound-core=y
CONFIG_PACKAGE_kmod-sound-soc-core=y
CONFIG_PACKAGE_kmod-sound-soc-sunxi=y
CONFIG_PACKAGE_kmod-spi-bitbang=y
CONFIG_PACKAGE_kmod-usb-net-cdc-eem=y
CONFIG_PACKAGE_kmod-usb-net-cdc-ether=y
CONFIG_PACKAGE_kmod-usb-net-cdc-mbim=y
CONFIG_PACKAGE_kmod-usb-net-cdc-ncm=y
CONFIG_PACKAGE_kmod-usb-net-rtl8150=y
CONFIG_PACKAGE_kmod-usb-net-rtl8152=y
CONFIG_PACKAGE_kmod-usb-otg-sunxi=y
CONFIG_PACKAGE_kmod-usb-serial-ch341=y
CONFIG_PACKAGE_kmod-usb-serial-cp210x=y
CONFIG_PACKAGE_kmod-usb-serial-pl2303=y
CONFIG_PACKAGE_kmod-usb-serial-xr_usb_serial_common=y
CONFIG_PACKAGE_libcap=m
CONFIG_PACKAGE_libcleri=y
CONFIG_PACKAGE_libiconv-full-full=m
CONFIG_PACKAGE_libiwinfo-lua=y
CONFIG_PACKAGE_libpcre2=y
CONFIG_PACKAGE_libuv=y
CONFIG_PACKAGE_libwebsockets-openssl=m
# CONFIG_PACKAGE_libwolfssl is not set
CONFIG_PACKAGE_luci-i18n-base-zh-cn=y
CONFIG_PACKAGE_luci-i18n-firewall-zh-cn=y
CONFIG_PACKAGE_luci-i18n-freeioe-zh-cn=y
CONFIG_PACKAGE_luci-i18n-opkg-zh-cn=y
CONFIG_PACKAGE_mosquitto-ssl=y
CONFIG_PACKAGE_mt7601u-firmware=y
CONFIG_PACKAGE_r8152-firmware=y
CONFIG_PACKAGE_robot-client=m
CONFIG_PACKAGE_robot-pong=m
CONFIG_PACKAGE_robot-server=m
CONFIG_PACKAGE_rt2800-usb-firmware=y
CONFIG_PACKAGE_rt73-usb-firmware=y
CONFIG_PACKAGE_rtl8192cu-firmware=y
CONFIG_PACKAGE_siridb-server=y
CONFIG_PACKAGE_wpad-basic-mbedtls=y
# CONFIG_PACKAGE_wpad-basic-wolfssl is not set
CONFIG_PACKAGE_yajl=y
CONFIG_PCRE2_JIT_ENABLED=y
CONFIG_SUNXI_SD_BOOT_PARTSIZE=20
CONFIG_TARGET_ROOTFS_PARTSIZE=256
# CONFIG_WOLFSSL_HAS_OPENVPN is not set
# CONFIG_WPA_WOLFSSL is not set
```
