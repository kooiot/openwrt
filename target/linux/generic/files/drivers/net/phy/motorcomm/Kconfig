## target/linux/generic/files/drivers/net/phy/motorcomm/Kconfig
```kconfig
menuconfig MOTORCOMM_PHY_EXT
	tristate "Motorcomm phy chips support"
	help
	  Currently supports the MOTORCOMM phy chips

config MOTORCOMM_YT8521S
	depends on MOTORCOMM_PHY_EXT
	tristate "Motorcomm YT8521S phy support"
	help
		Currently supports the YT8521S PHY

config MOTORCOMM_YT8512C
	depends on MOTORCOMM_PHY_EXT
	tristate "Motorcomm YT8521C phy support"
	help
		Currently supports the YT8512C PHY
```

## target/linux/generic/files/drivers/tty/serial/wk2xxx_spi/Kconfig
```kconfig
config SERIAL_WK2XXX_SPI
	tristate "WKMIC WK2xxx spi to uart Support"
	help
      This selects the  wk2xxx connected to MediaTek chips.
      If you want to use wk2xxx support, say Y or M here.
      If unsure, say N.
```

## target/linux/generic/files/drivers/tty/serial/wk2xxx_spi_v2.2/Kconfig
```kconfig
config SERIAL_WK2XXX_SPI
	tristate "WKMIC WK2xxx spi to uart Support"
	help
      This selects the  wk2xxx connected via SPI bus.
      If you want to use wk2xxx support, say Y or M here.
      If unsure, say N.
```

## target/linux/generic/files/drivers/tty/serial/xr14xx_usb/Kconfig
```kconfig
config SERIAL_XR14XX_USB
	tristate "MaxLiner XR14xx usb to uart Support"
	help
      This selects the XR14xx connected to MaxLiner chips.
      If you want to use XR14xx support, say Y or M here.
      If unsure, say N.

if SERIAL_XR14XX_USB

config SERIAL_XR14XX_FORCE_485
	bool "Force using 485 mode"
	depends on SERIAL_XR14XX_USB
	help
	  force using rs485 mode

endif # SERIAL_XR14XX_USB
```

## target/linux/sophgo/image/Config.in
```kconfig
config SOPHGO_SD_BOOT_PARTSIZE
	int "Boot (SD Card) filesystem partition size (in MB)"
	depends on TARGET_sophgo
	default 32
```

## target/linux/sunxi/image/Config.in
```kconfig
config SUNXI_SD_BOOT_PARTSIZE
	int "Boot (SD Card) filesystem partition size (in MB)"
	depends on TARGET_sunxi
	default 40

if TARGET_sunxi_cortexa7

menuconfig SUN8I_V3S_SPINAND_OPTIONS
	bool "SPI-NAND options"
	default y if TARGET_sunxi_cortexa7

config SUNXI_SPINAND_PAGESIZE
	int "SPI-NAND pagesize size"
	depends on TARGET_sunxi_cortexa7
	depends on SUN8I_V3S_SPINAND_OPTIONS
	default 2048
	range 1024 8192

config SUNXI_SPINAND_BLOCKSIZE
	int "SPI-NAND block-size (in KiB)"
	depends on TARGET_sunxi_cortexa7
	depends on SUN8I_V3S_SPINAND_OPTIONS
	default 128

config SUN8I_V3S_OFFSET_UBI
	int "Offset of ubi in the spi-nand"
	depends on TARGET_sunxi_cortexa7
	depends on SUN8I_V3S_SPINAND_OPTIONS
	default 1048576 if SUNXI_SPINAND_PAGESIZE = 2048

endif # TARGET_sunxi_cortexa7
```

## thingslink/bananapi_m2u_defconfig
```kconfig
CONFIG_TARGET_sunxi=y
CONFIG_TARGET_sunxi_cortexa7=y
CONFIG_TARGET_sunxi_cortexa7_DEVICE_sinovoip_bananapi-m2-ultra=y
CONFIG_KERNEL_IO_URING=y
CONFIG_LCD4LINUX_CUSTOM_DRIVER_FW8888=y
CONFIG_LCD4LINUX_CUSTOM_DRIVER_GLCD2USB=y
CONFIG_LCD4LINUX_CUSTOM_DRIVER_LCD2USB=y
CONFIG_LCD4LINUX_CUSTOM_DRIVER_LEDMatrix=y
CONFIG_LCD4LINUX_CUSTOM_DRIVER_MatrixOrbital=y
CONFIG_LCD4LINUX_CUSTOM_DRIVER_MatrixOrbitalGX=y
CONFIG_LCD4LINUX_CUSTOM_DRIVER_NULL=y
CONFIG_LCD4LINUX_CUSTOM_DRIVER_PNG=y
CONFIG_LCD4LINUX_CUSTOM_DRIVER_USBLCD=y
CONFIG_LCD4LINUX_CUSTOM_NEEDS_libgd=y
CONFIG_LCD4LINUX_CUSTOM_NEEDS_libusb=y
CONFIG_LCD4LINUX_CUSTOM_NEEDS_ppp=y
CONFIG_LCD4LINUX_CUSTOM_PLUGIN_button_exec=y
CONFIG_LCD4LINUX_CUSTOM_PLUGIN_cpuinfo=y
CONFIG_LCD4LINUX_CUSTOM_PLUGIN_diskstats=y
CONFIG_LCD4LINUX_CUSTOM_PLUGIN_event=y
CONFIG_LCD4LINUX_CUSTOM_PLUGIN_exec=y
CONFIG_LCD4LINUX_CUSTOM_PLUGIN_file=y
CONFIG_LCD4LINUX_CUSTOM_PLUGIN_loadavg=y
CONFIG_LCD4LINUX_CUSTOM_PLUGIN_meminfo=y
CONFIG_LCD4LINUX_CUSTOM_PLUGIN_netdev=y
CONFIG_LCD4LINUX_CUSTOM_PLUGIN_netinfo=y
CONFIG_LCD4LINUX_CUSTOM_PLUGIN_ppp=y
CONFIG_LCD4LINUX_CUSTOM_PLUGIN_proc_stat=y
CONFIG_LCD4LINUX_CUSTOM_PLUGIN_statfs=y
CONFIG_LCD4LINUX_CUSTOM_PLUGIN_uname=y
CONFIG_LCD4LINUX_CUSTOM_PLUGIN_uptime=y
CONFIG_LIBCURL_COOKIES=y
CONFIG_LIBCURL_FILE=y
CONFIG_LIBCURL_FTP=y
CONFIG_LIBCURL_HTTP=y
CONFIG_LIBCURL_MBEDTLS=y
CONFIG_LIBCURL_NGHTTP2=y
CONFIG_LIBCURL_NO_SMB="!"
CONFIG_LIBCURL_PROXY=y
CONFIG_LUCI_LANG_zh_Hans=y
CONFIG_OPENSSL_ENGINE=y
CONFIG_OPENSSL_ENGINE_BUILTIN=y
CONFIG_OPENSSL_PREFER_CHACHA_OVER_GCM=y
CONFIG_OPENSSL_WITH_ASM=y
CONFIG_OPENSSL_WITH_CHACHA_POLY1305=y
CONFIG_OPENSSL_WITH_CMS=y
CONFIG_OPENSSL_WITH_DEPRECATED=y
CONFIG_OPENSSL_WITH_ERROR_MESSAGES=y
CONFIG_OPENSSL_WITH_PSK=y
CONFIG_OPENSSL_WITH_SM234=y
CONFIG_OPENSSL_WITH_SRP=y
CONFIG_OPENSSL_WITH_TLS13=y
CONFIG_PACKAGE_3ginfo-text=y
CONFIG_PACKAGE_MAC80211_DEBUGFS=y
CONFIG_PACKAGE_MAC80211_MESH=y
CONFIG_PACKAGE_block-mount=y
CONFIG_PACKAGE_blockd=y
CONFIG_PACKAGE_cgi-io=y
CONFIG_PACKAGE_chat=y
CONFIG_PACKAGE_comgt=y
CONFIG_PACKAGE_fdisk=y
CONFIG_PACKAGE_freeioe=y
CONFIG_PACKAGE_kmod-ac97=y
CONFIG_PACKAGE_kmod-backlight=y
CONFIG_PACKAGE_kmod-backlight-pwm=y
CONFIG_PACKAGE_kmod-crypto-aead=y
CONFIG_PACKAGE_kmod-crypto-ccm=y
CONFIG_PACKAGE_kmod-crypto-cmac=y
CONFIG_PACKAGE_kmod-crypto-ctr=y
CONFIG_PACKAGE_kmod-crypto-gcm=y
CONFIG_PACKAGE_kmod-crypto-gf128=y
CONFIG_PACKAGE_kmod-crypto-ghash=y
CONFIG_PACKAGE_kmod-crypto-hmac=y
CONFIG_PACKAGE_kmod-crypto-manager=y
CONFIG_PACKAGE_kmod-crypto-null=y
CONFIG_PACKAGE_kmod-crypto-rng=y
CONFIG_PACKAGE_kmod-crypto-seqiv=y
CONFIG_PACKAGE_kmod-crypto-sha256=y
CONFIG_PACKAGE_kmod-crypto-sha512=y
CONFIG_PACKAGE_kmod-dma-buf=y
CONFIG_PACKAGE_kmod-drm=y
CONFIG_PACKAGE_kmod-drm-kms-helper=y
CONFIG_PACKAGE_kmod-drm-sun8i=y
CONFIG_PACKAGE_kmod-drm-sun8i-dsi=y
CONFIG_PACKAGE_kmod-drm-sun8i-hdmi=y
CONFIG_PACKAGE_kmod-fb=y
CONFIG_PACKAGE_kmod-fb-cfb-copyarea=y
CONFIG_PACKAGE_kmod-fb-cfb-fillrect=y
CONFIG_PACKAGE_kmod-fb-cfb-imgblt=y
CONFIG_PACKAGE_kmod-fb-sys-fops=y
CONFIG_PACKAGE_kmod-fb-sys-ram=y
CONFIG_PACKAGE_kmod-fs-autofs4=y
CONFIG_PACKAGE_kmod-fs-configfs=y
CONFIG_PACKAGE_kmod-hid=y
CONFIG_PACKAGE_kmod-hid-generic=y
CONFIG_PACKAGE_kmod-i2c-core=y
CONFIG_PACKAGE_kmod-input-core=y
CONFIG_PACKAGE_kmod-input-evdev=y
CONFIG_PACKAGE_kmod-input-touchscreen-goodix=y
CONFIG_PACKAGE_kmod-libphy=y
CONFIG_PACKAGE_kmod-mac80211=y
CONFIG_PACKAGE_kmod-mdio-devres=y
CONFIG_PACKAGE_kmod-mii=y
CONFIG_PACKAGE_kmod-mt7601u=y
CONFIG_PACKAGE_kmod-net-selftests=y
CONFIG_PACKAGE_kmod-nf-nat6=y
CONFIG_PACKAGE_kmod-phy-ax88796b=y
CONFIG_PACKAGE_kmod-pwm-sun8i=y
CONFIG_PACKAGE_kmod-regmap-core=y
CONFIG_PACKAGE_kmod-rt2800-lib=y
CONFIG_PACKAGE_kmod-rt2800-usb=y
CONFIG_PACKAGE_kmod-rt2x00-lib=y
CONFIG_PACKAGE_kmod-rt2x00-usb=y
CONFIG_PACKAGE_kmod-rtl8192c-common=y
CONFIG_PACKAGE_kmod-rtl8192cu=y
CONFIG_PACKAGE_kmod-rtl8xxxu=y
CONFIG_PACKAGE_kmod-rtlwifi=y
CONFIG_PACKAGE_kmod-rtlwifi-usb=y
CONFIG_PACKAGE_kmod-sound-core=y
CONFIG_PACKAGE_kmod-sound-soc-core=y
CONFIG_PACKAGE_kmod-sound-soc-sunxi=y
CONFIG_PACKAGE_kmod-usb-gadget=y
CONFIG_PACKAGE_kmod-usb-gadget-eth=y
CONFIG_PACKAGE_kmod-usb-gadget-serial=y
CONFIG_PACKAGE_kmod-usb-hid=y
CONFIG_PACKAGE_kmod-usb-hid-cp2112=y
CONFIG_PACKAGE_kmod-usb-hub-251xb=y
CONFIG_PACKAGE_kmod-usb-lib-composite=y
CONFIG_PACKAGE_kmod-usb-net=y
CONFIG_PACKAGE_kmod-usb-net-asix=y
CONFIG_PACKAGE_kmod-usb-net-cdc-eem=y
CONFIG_PACKAGE_kmod-usb-net-cdc-ether=y
CONFIG_PACKAGE_kmod-usb-net-cdc-mbim=y
CONFIG_PACKAGE_kmod-usb-net-cdc-ncm=y
CONFIG_PACKAGE_kmod-usb-net-huawei-cdc-ncm=y
CONFIG_PACKAGE_kmod-usb-net-qmi-wwan=y
CONFIG_PACKAGE_kmod-usb-net-rndis=y
CONFIG_PACKAGE_kmod-usb-otg-sunxi=y
CONFIG_PACKAGE_kmod-usb-serial=y
CONFIG_PACKAGE_kmod-usb-serial-ch341=y
CONFIG_PACKAGE_kmod-usb-serial-cp210x=y
CONFIG_PACKAGE_kmod-usb-serial-option=y
CONFIG_PACKAGE_kmod-usb-serial-pl2303=y
CONFIG_PACKAGE_kmod-usb-serial-wwan=y
CONFIG_PACKAGE_kmod-usb-storage=y
CONFIG_PACKAGE_kmod-usb-wdm=y
CONFIG_PACKAGE_kmod-xradio=y
CONFIG_PACKAGE_lcd4linux-custom=y
CONFIG_PACKAGE_libatomic=y
CONFIG_PACKAGE_libcleri=y
CONFIG_PACKAGE_libcurl=y
CONFIG_PACKAGE_libfdisk=y
CONFIG_PACKAGE_libgd=y
CONFIG_PACKAGE_libiwinfo-lua=y
CONFIG_PACKAGE_libjpeg-turbo=y
CONFIG_PACKAGE_liblua=y
CONFIG_PACKAGE_liblucihttp=y
CONFIG_PACKAGE_liblucihttp-lua=y
CONFIG_PACKAGE_liblucihttp-ucode=y
CONFIG_PACKAGE_libncurses=y
CONFIG_PACKAGE_libnghttp2=y
CONFIG_PACKAGE_libopenssl=y
CONFIG_PACKAGE_libpcre2=y
CONFIG_PACKAGE_libpng=y
CONFIG_PACKAGE_libstdcpp=y
CONFIG_PACKAGE_libubus-lua=y
CONFIG_PACKAGE_libusb-1.0=y
CONFIG_PACKAGE_libusb-compat=y
CONFIG_PACKAGE_libuv=y
CONFIG_PACKAGE_libwebp=y
CONFIG_PACKAGE_lua=y
CONFIG_PACKAGE_luci=y
CONFIG_PACKAGE_luci-app-firewall=y
CONFIG_PACKAGE_luci-app-freeioe=y
CONFIG_PACKAGE_luci-app-opkg=y
CONFIG_PACKAGE_luci-base=y
CONFIG_PACKAGE_luci-i18n-base-zh-cn=y
CONFIG_PACKAGE_luci-i18n-firewall-zh-cn=y
CONFIG_PACKAGE_luci-i18n-freeioe-zh-cn=y
CONFIG_PACKAGE_luci-i18n-opkg-zh-cn=y
CONFIG_PACKAGE_luci-lib-base=y
CONFIG_PACKAGE_luci-lib-ip=y
CONFIG_PACKAGE_luci-lib-jsonc=y
CONFIG_PACKAGE_luci-lib-nixio=y
CONFIG_PACKAGE_luci-light=y
CONFIG_PACKAGE_luci-lua-runtime=y
CONFIG_PACKAGE_luci-mod-admin-full=y
CONFIG_PACKAGE_luci-mod-network=y
CONFIG_PACKAGE_luci-mod-status=y
CONFIG_PACKAGE_luci-mod-system=y
CONFIG_PACKAGE_luci-proto-3g=y
CONFIG_PACKAGE_luci-proto-ipv6=y
CONFIG_PACKAGE_luci-proto-ppp=y
CONFIG_PACKAGE_luci-proto-qmi=y
CONFIG_PACKAGE_luci-theme-bootstrap=y
CONFIG_PACKAGE_mt7601u-firmware=y
CONFIG_PACKAGE_process-monitor=y
CONFIG_PACKAGE_rpcd=y
CONFIG_PACKAGE_rpcd-mod-file=y
CONFIG_PACKAGE_rpcd-mod-iwinfo=y
CONFIG_PACKAGE_rpcd-mod-luci=y
CONFIG_PACKAGE_rpcd-mod-rrdns=y
CONFIG_PACKAGE_rpcd-mod-ucode=y
CONFIG_PACKAGE_rt2800-usb-firmware=y
CONFIG_PACKAGE_rtl8192cu-firmware=y
CONFIG_PACKAGE_shellinabox=y
CONFIG_PACKAGE_siridb-server=y
CONFIG_PACKAGE_skynet=y
CONFIG_PACKAGE_terminfo=y
CONFIG_PACKAGE_tlink-usb2lcd=y
CONFIG_PACKAGE_tlink-utility=y
CONFIG_PACKAGE_ucode-mod-html=y
CONFIG_PACKAGE_ucode-mod-lua=y
CONFIG_PACKAGE_ucode-mod-math=y
CONFIG_PACKAGE_uhttpd=y
CONFIG_PACKAGE_uhttpd-mod-ubus=y
CONFIG_PACKAGE_unzip=y
CONFIG_PACKAGE_uqmi=y
CONFIG_PACKAGE_wwan=y
CONFIG_PACKAGE_wwanleds=y
CONFIG_PACKAGE_yajl=y
CONFIG_PACKAGE_zip=y
CONFIG_PACKAGE_zlib=y
CONFIG_PCRE2_JIT_ENABLED=y
CONFIG_SUNXI_SD_BOOT_PARTSIZE=20
CONFIG_TARGET_ROOTFS_PARTSIZE=256
# CONFIG_WOLFSSL_HAS_OPENVPN is not set
# CONFIG_LIBCURL_UNIX_SOCKETS is not set
# CONFIG_OPENSSL_WITH_IDEA is not set
# CONFIG_OPENSSL_WITH_MDC2 is not set
# CONFIG_OPENSSL_WITH_SEED is not set
# CONFIG_OPENSSL_WITH_WHIRLPOOL is not set
```

## thingslink/firefly_roc_pc_defconfig
```kconfig
CONFIG_TARGET_rockchip=y
CONFIG_TARGET_rockchip_armv8=y
CONFIG_TARGET_rockchip_armv8_DEVICE_firefly_firefly-roc-pc=y
CONFIG_BRCMFMAC_SDIO=y
# CONFIG_LIBCURL_UNIX_SOCKETS is not set
# CONFIG_LUA_ECO_MBEDTLS is not set
CONFIG_LUA_ECO_OPENSSL=y
# CONFIG_OPENSSL_WITH_IDEA is not set
# CONFIG_OPENSSL_WITH_MDC2 is not set
# CONFIG_OPENSSL_WITH_SEED is not set
# CONFIG_OPENSSL_WITH_WHIRLPOOL is not set
CONFIG_PACKAGE_libiwinfo-lua=y
# CONFIG_PACKAGE_libustream-mbedtls is not set
CONFIG_PACKAGE_libustream-wolfssl=y
CONFIG_PACKAGE_libwolfssl=y
CONFIG_PACKAGE_wpad-openssl=m
CONFIG_TARGET_KERNEL_PARTSIZE=32
CONFIG_TARGET_ROOTFS_PARTSIZE=256
CONFIG_WOLFSSL_HAS_NO_HW=y
CONFIG_WPA_MBO_SUPPORT=y
```

## thingslink/lichee_zero_plus_defconfig
```kconfig
CONFIG_TARGET_sunxi=y
CONFIG_TARGET_sunxi_cortexa7=y
CONFIG_TARGET_sunxi_cortexa7_DEVICE_sipeed_lichee-zero-plus=y
CONFIG_GENSIO_PTHREADS=y
CONFIG_KERNEL_IO_URING=y
CONFIG_LIBCURL_COOKIES=y
CONFIG_LIBCURL_FILE=y
CONFIG_LIBCURL_FTP=y
CONFIG_LIBCURL_HTTP=y
CONFIG_LIBCURL_NGHTTP2=y
CONFIG_LIBCURL_NO_SMB="!"
CONFIG_LIBCURL_PROXY=y
CONFIG_LIBCURL_WOLFSSL=y
CONFIG_LUCI_LANG_zh_Hans=y
CONFIG_OPENSSL_ENGINE=y
CONFIG_OPENSSL_ENGINE_BUILTIN=y
CONFIG_OPENSSL_PREFER_CHACHA_OVER_GCM=y
CONFIG_OPENSSL_WITH_ASM=y
CONFIG_OPENSSL_WITH_CHACHA_POLY1305=y
CONFIG_OPENSSL_WITH_CMS=y
CONFIG_OPENSSL_WITH_DEPRECATED=y
CONFIG_OPENSSL_WITH_ERROR_MESSAGES=y
CONFIG_OPENSSL_WITH_PSK=y
CONFIG_OPENSSL_WITH_SM234=y
CONFIG_OPENSSL_WITH_SRP=y
CONFIG_OPENSSL_WITH_TLS13=y
CONFIG_PACKAGE_3ginfo-text=y
CONFIG_PACKAGE_block-mount=y
CONFIG_PACKAGE_blockd=y
CONFIG_PACKAGE_cJSON=m
CONFIG_PACKAGE_cgi-io=y
CONFIG_PACKAGE_chat=y
CONFIG_PACKAGE_comgt=y
CONFIG_PACKAGE_fdisk=y
CONFIG_PACKAGE_freeioe=y
CONFIG_PACKAGE_kmod-ac97=y
CONFIG_PACKAGE_kmod-backlight=y
CONFIG_PACKAGE_kmod-backlight-pwm=y
CONFIG_PACKAGE_kmod-dma-buf=y
CONFIG_PACKAGE_kmod-drm=y
CONFIG_PACKAGE_kmod-drm-kms-helper=y
CONFIG_PACKAGE_kmod-drm-sun8i=y
CONFIG_PACKAGE_kmod-drm-sun8i-dsi=y
CONFIG_PACKAGE_kmod-drm-sun8i-hdmi=y
CONFIG_PACKAGE_kmod-fb=y
CONFIG_PACKAGE_kmod-fb-cfb-copyarea=y
CONFIG_PACKAGE_kmod-fb-cfb-fillrect=y
CONFIG_PACKAGE_kmod-fb-cfb-imgblt=y
CONFIG_PACKAGE_kmod-fb-sys-fops=y
CONFIG_PACKAGE_kmod-fb-sys-ram=y
CONFIG_PACKAGE_kmod-fs-autofs4=y
CONFIG_PACKAGE_kmod-i2c-core=y
CONFIG_PACKAGE_kmod-input-core=y
CONFIG_PACKAGE_kmod-input-evdev=y
CONFIG_PACKAGE_kmod-input-touchscreen-goodix=y
CONFIG_PACKAGE_kmod-mii=y
CONFIG_PACKAGE_kmod-nf-nat6=y
CONFIG_PACKAGE_kmod-nls-base=y
CONFIG_PACKAGE_kmod-pwm-sun8i=y
CONFIG_PACKAGE_kmod-regmap-core=y
CONFIG_PACKAGE_kmod-sound-core=y
CONFIG_PACKAGE_kmod-sound-soc-core=y
CONFIG_PACKAGE_kmod-sound-soc-sunxi=y
CONFIG_PACKAGE_kmod-usb-core=y
CONFIG_PACKAGE_kmod-usb-net=y
CONFIG_PACKAGE_kmod-usb-net-qmi-wwan=y
CONFIG_PACKAGE_kmod-usb-wdm=y
CONFIG_PACKAGE_libatomic=y
CONFIG_PACKAGE_libcap=m
CONFIG_PACKAGE_libcleri=y
CONFIG_PACKAGE_libcurl=y
CONFIG_PACKAGE_libfdisk=y
CONFIG_PACKAGE_libgensio=y
CONFIG_PACKAGE_libiwinfo=y
CONFIG_PACKAGE_libiwinfo-data=y
CONFIG_PACKAGE_libiwinfo-lua=y
CONFIG_PACKAGE_liblua=y
CONFIG_PACKAGE_liblucihttp=y
CONFIG_PACKAGE_liblucihttp-lua=y
CONFIG_PACKAGE_liblucihttp-ucode=y
# CONFIG_PACKAGE_libmbedtls is not set
CONFIG_PACKAGE_libncurses=y
CONFIG_PACKAGE_libnghttp2=y
CONFIG_PACKAGE_libopenssl=y
CONFIG_PACKAGE_libpcre2=y
CONFIG_PACKAGE_libstdcpp=y
CONFIG_PACKAGE_libubus-lua=y
# CONFIG_PACKAGE_libustream-mbedtls is not set
CONFIG_PACKAGE_libustream-wolfssl=y
CONFIG_PACKAGE_libuv=y
CONFIG_PACKAGE_libwebsockets-openssl=m
CONFIG_PACKAGE_libwolfssl=y
CONFIG_PACKAGE_libyaml=y
CONFIG_PACKAGE_lua=y
CONFIG_PACKAGE_luci=y
CONFIG_PACKAGE_luci-app-firewall=y
CONFIG_PACKAGE_luci-app-opkg=y
CONFIG_PACKAGE_luci-app-ser2net=y
CONFIG_PACKAGE_luci-base=y
CONFIG_PACKAGE_luci-i18n-base-zh-cn=y
CONFIG_PACKAGE_luci-i18n-firewall-zh-cn=y
CONFIG_PACKAGE_luci-i18n-opkg-zh-cn=y
CONFIG_PACKAGE_luci-i18n-ser2net-zh-cn=y
CONFIG_PACKAGE_luci-lib-base=y
CONFIG_PACKAGE_luci-lib-ip=y
CONFIG_PACKAGE_luci-lib-jsonc=y
CONFIG_PACKAGE_luci-lib-nixio=y
CONFIG_PACKAGE_luci-light=y
CONFIG_PACKAGE_luci-mod-admin-full=y
CONFIG_PACKAGE_luci-mod-network=y
CONFIG_PACKAGE_luci-mod-status=y
CONFIG_PACKAGE_luci-mod-system=y
CONFIG_PACKAGE_luci-proto-3g=y
CONFIG_PACKAGE_luci-proto-ipv6=y
CONFIG_PACKAGE_luci-proto-ppp=y
CONFIG_PACKAGE_luci-proto-qmi=y
CONFIG_PACKAGE_luci-theme-bootstrap=y
CONFIG_PACKAGE_mosquitto-nossl=y
CONFIG_PACKAGE_process-monitor=y
CONFIG_PACKAGE_rpcd=y
CONFIG_PACKAGE_rpcd-mod-file=y
CONFIG_PACKAGE_rpcd-mod-iwinfo=y
CONFIG_PACKAGE_rpcd-mod-luci=y
CONFIG_PACKAGE_rpcd-mod-rrdns=y
CONFIG_PACKAGE_rpcd-mod-ucode=y
CONFIG_PACKAGE_ser2net=y
CONFIG_PACKAGE_shellinabox=y
CONFIG_PACKAGE_siridb-server=y
CONFIG_PACKAGE_skynet=y
CONFIG_PACKAGE_terminfo=y
CONFIG_PACKAGE_tlink-utility=y
CONFIG_PACKAGE_ucode-mod-html=y
CONFIG_PACKAGE_ucode-mod-math=y
CONFIG_PACKAGE_uhttpd=y
CONFIG_PACKAGE_uhttpd-mod-ubus=y
CONFIG_PACKAGE_unzip=y
CONFIG_PACKAGE_uqmi=y
CONFIG_PACKAGE_wwan=y
CONFIG_PACKAGE_wwanleds=y
CONFIG_PACKAGE_yajl=y
CONFIG_PACKAGE_zip=y
CONFIG_PACKAGE_zlib=y
CONFIG_PCRE2_JIT_ENABLED=y
CONFIG_SUNXI_SD_BOOT_PARTSIZE=20
CONFIG_TARGET_ROOTFS_PARTSIZE=256
CONFIG_WOLFSSL_HAS_NO_HW=y
# CONFIG_WOLFSSL_HAS_OPENVPN is not set
# CONFIG_LIBCURL_UNIX_SOCKETS is not set
# CONFIG_OPENSSL_WITH_IDEA is not set
# CONFIG_OPENSSL_WITH_MDC2 is not set
# CONFIG_OPENSSL_WITH_SEED is not set
# CONFIG_OPENSSL_WITH_WHIRLPOOL is not set
```
