## thingslink/tlink_m416_symlink_defconfig
```kconfig
CONFIG_TARGET_sunxi=y
CONFIG_TARGET_sunxi_cortexa7=y
CONFIG_TARGET_sunxi_cortexa7_DEVICE_kooiot_tlink-m416=y
CONFIG_KERNEL_DEVTMPFS=y
CONFIG_KERNEL_IO_URING=y
# CONFIG_LIBCURL_UNIX_SOCKETS is not set
CONFIG_LUCI_LANG_zh_Hans=y
# CONFIG_OPENSSL_ENGINE_BUILTIN is not set
# CONFIG_OPENSSL_WITH_IDEA is not set
# CONFIG_OPENSSL_WITH_MDC2 is not set
# CONFIG_OPENSSL_WITH_SEED is not set
# CONFIG_OPENSSL_WITH_SM234 is not set
# CONFIG_OPENSSL_WITH_WHIRLPOOL is not set
CONFIG_PACKAGE_factory-tlink=m
# CONFIG_PACKAGE_freeioe is not set
# CONFIG_PACKAGE_ip-full is not set
# CONFIG_PACKAGE_kmod-can-bcm is not set
# CONFIG_PACKAGE_kmod-can-raw is not set
CONFIG_PACKAGE_kmod-dp83848-phy=y
CONFIG_PACKAGE_kmod-nf-nat6=y
CONFIG_PACKAGE_kmod-usb-hub-251xb=y
CONFIG_PACKAGE_kmod-usb-net-cdc-ether=y
CONFIG_PACKAGE_kmod-usb-net-cdc-mbim=y
CONFIG_PACKAGE_kmod-usb-net-cdc-ncm=y
# CONFIG_PACKAGE_libbpf is not set
# CONFIG_PACKAGE_libelf is not set
CONFIG_PACKAGE_libiwinfo-lua=y
# CONFIG_PACKAGE_liblucihttp-lua is not set
CONFIG_PACKAGE_libopenssl-v1=y
# CONFIG_PACKAGE_libubus-lua is not set
# CONFIG_PACKAGE_libwolfssl is not set
# CONFIG_PACKAGE_lua is not set
# CONFIG_PACKAGE_luci-app-freeioe is not set
CONFIG_PACKAGE_luci-i18n-base-zh-cn=y
CONFIG_PACKAGE_luci-i18n-firewall-zh-cn=y
CONFIG_PACKAGE_luci-i18n-package-manager-zh-cn=y
CONFIG_PACKAGE_luci-i18n-ser2net-zh-cn=y
# CONFIG_PACKAGE_luci-lib-base is not set
# CONFIG_PACKAGE_luci-lib-ip is not set
# CONFIG_PACKAGE_luci-lib-jsonc is not set
# CONFIG_PACKAGE_luci-lib-nixio is not set
# CONFIG_PACKAGE_luci-lua-runtime is not set
# CONFIG_PACKAGE_process-monitor is not set
CONFIG_PACKAGE_robot-client=m
CONFIG_PACKAGE_robot-pong=m
CONFIG_PACKAGE_robot-server=m
# CONFIG_PACKAGE_skynet is not set
CONFIG_PACKAGE_symlink-openssl-v1=y
CONFIG_PACKAGE_symlink-projects-symgrid-com=y
CONFIG_PACKAGE_symlink-psn=y
# CONFIG_PACKAGE_ucode-mod-lua is not set
CONFIG_PACKAGE_wpad-basic-mbedtls=y
# CONFIG_PACKAGE_wpad-basic-wolfssl is not set
CONFIG_SUNXI_SD_BOOT_PARTSIZE=20
CONFIG_TARGET_ROOTFS_PARTSIZE=256
# CONFIG_WOLFSSL_HAS_OPENVPN is not set
# CONFIG_WPA_WOLFSSL is not set
```

## thingslink/tlink_nano-a40i_defconfig
```kconfig
CONFIG_TARGET_sunxi=y
CONFIG_TARGET_sunxi_cortexa7=y
CONFIG_TARGET_sunxi_cortexa7_DEVICE_kooiot_tlink-nano-a40i=y
CONFIG_KERNEL_DEVTMPFS=y
CONFIG_KERNEL_IO_URING=y
CONFIG_LCD4LINUX_CUSTOM_DRIVER_FW8888=y
CONFIG_LCD4LINUX_CUSTOM_DRIVER_GLCD2USB=y
CONFIG_LCD4LINUX_CUSTOM_DRIVER_LCD2USB=y
CONFIG_LCD4LINUX_CUSTOM_DRIVER_LEDMatrix=y
CONFIG_LCD4LINUX_CUSTOM_DRIVER_MatrixOrbital=y
CONFIG_LCD4LINUX_CUSTOM_DRIVER_MatrixOrbitalGX=y
CONFIG_LCD4LINUX_CUSTOM_DRIVER_NULL=y
CONFIG_LCD4LINUX_CUSTOM_DRIVER_PNG=y
CONFIG_LCD4LINUX_CUSTOM_DRIVER_USBLCD=y
CONFIG_LCD4LINUX_CUSTOM_NEEDS_libgd=y
CONFIG_LCD4LINUX_CUSTOM_NEEDS_libusb=y
CONFIG_LCD4LINUX_CUSTOM_NEEDS_ppp=y
CONFIG_LCD4LINUX_CUSTOM_PLUGIN_button_exec=y
CONFIG_LCD4LINUX_CUSTOM_PLUGIN_cpuinfo=y
CONFIG_LCD4LINUX_CUSTOM_PLUGIN_diskstats=y
CONFIG_LCD4LINUX_CUSTOM_PLUGIN_event=y
CONFIG_LCD4LINUX_CUSTOM_PLUGIN_exec=y
CONFIG_LCD4LINUX_CUSTOM_PLUGIN_file=y
CONFIG_LCD4LINUX_CUSTOM_PLUGIN_loadavg=y
CONFIG_LCD4LINUX_CUSTOM_PLUGIN_meminfo=y
CONFIG_LCD4LINUX_CUSTOM_PLUGIN_netdev=y
CONFIG_LCD4LINUX_CUSTOM_PLUGIN_netinfo=y
CONFIG_LCD4LINUX_CUSTOM_PLUGIN_ppp=y
CONFIG_LCD4LINUX_CUSTOM_PLUGIN_proc_stat=y
CONFIG_LCD4LINUX_CUSTOM_PLUGIN_statfs=y
CONFIG_LCD4LINUX_CUSTOM_PLUGIN_uname=y
CONFIG_LCD4LINUX_CUSTOM_PLUGIN_uptime=y
# CONFIG_LIBCURL_UNIX_SOCKETS is not set
CONFIG_LUCI_LANG_zh_Hans=y
# CONFIG_OPENSSL_WITH_IDEA is not set
# CONFIG_OPENSSL_WITH_MDC2 is not set
# CONFIG_OPENSSL_WITH_SEED is not set
# CONFIG_OPENSSL_WITH_WHIRLPOOL is not set
CONFIG_PACKAGE_focas-ubus=y
CONFIG_PACKAGE_kmod-nf-nat6=y
CONFIG_PACKAGE_lcd4linux-custom=y
CONFIG_PACKAGE_libgd=y
CONFIG_PACKAGE_libiwinfo-lua=y
CONFIG_PACKAGE_libjpeg-turbo=y
CONFIG_PACKAGE_libpng=y
CONFIG_PACKAGE_libusb-compat=y
CONFIG_PACKAGE_libwebp=y
# CONFIG_PACKAGE_libwolfssl is not set
CONFIG_PACKAGE_luci-i18n-base-zh-cn=y
CONFIG_PACKAGE_luci-i18n-ddns-zh-cn=y
CONFIG_PACKAGE_luci-i18n-firewall-zh-cn=y
CONFIG_PACKAGE_luci-i18n-freeioe-zh-cn=y
CONFIG_PACKAGE_luci-i18n-opkg-zh-cn=y
CONFIG_PACKAGE_luci-i18n-ser2net-zh-cn=y
CONFIG_PACKAGE_luci-lib-ipkg=y
CONFIG_PACKAGE_tlink-usb2lcd=y
CONFIG_PACKAGE_wpad-basic-mbedtls=y
# CONFIG_PACKAGE_wpad-basic-wolfssl is not set
CONFIG_SUNXI_SD_BOOT_PARTSIZE=20
CONFIG_TARGET_ROOTFS_PARTSIZE=256
# CONFIG_WOLFSSL_HAS_OPENVPN is not set
# CONFIG_WPA_WOLFSSL is not set
```

## thingslink/tlink_ok-a40i_defconfig
```kconfig
CONFIG_TARGET_sunxi=y
CONFIG_TARGET_sunxi_cortexa7=y
CONFIG_TARGET_sunxi_cortexa7_DEVICE_kooiot_tlink-ok-a40i=y
CONFIG_KERNEL_IO_URING=y
# CONFIG_LIBCURL_UNIX_SOCKETS is not set
CONFIG_LUCI_LANG_zh_Hans=y
# CONFIG_OPENSSL_WITH_IDEA is not set
# CONFIG_OPENSSL_WITH_MDC2 is not set
# CONFIG_OPENSSL_WITH_SEED is not set
# CONFIG_OPENSSL_WITH_WHIRLPOOL is not set
CONFIG_PACKAGE_MAC80211_DEBUGFS=y
CONFIG_PACKAGE_MAC80211_MESH=y
CONFIG_PACKAGE_armbian-firmware-xr819=y
CONFIG_PACKAGE_fontconfig=y
CONFIG_PACKAGE_kmod-ac97=y
CONFIG_PACKAGE_kmod-backlight=y
CONFIG_PACKAGE_kmod-backlight-pwm=y
CONFIG_PACKAGE_kmod-crypto-aead=y
CONFIG_PACKAGE_kmod-crypto-ccm=y
CONFIG_PACKAGE_kmod-crypto-cmac=y
CONFIG_PACKAGE_kmod-crypto-ctr=y
CONFIG_PACKAGE_kmod-crypto-gcm=y
CONFIG_PACKAGE_kmod-crypto-gf128=y
CONFIG_PACKAGE_kmod-crypto-ghash=y
CONFIG_PACKAGE_kmod-crypto-hmac=y
CONFIG_PACKAGE_kmod-crypto-manager=y
CONFIG_PACKAGE_kmod-crypto-null=y
CONFIG_PACKAGE_kmod-crypto-rng=y
CONFIG_PACKAGE_kmod-crypto-seqiv=y
CONFIG_PACKAGE_kmod-crypto-sha256=y
CONFIG_PACKAGE_kmod-crypto-sha512=y
CONFIG_PACKAGE_kmod-dma-buf=y
CONFIG_PACKAGE_kmod-drm=y
CONFIG_PACKAGE_kmod-drm-kms-helper=y
CONFIG_PACKAGE_kmod-drm-sun8i=y
CONFIG_PACKAGE_kmod-drm-sun8i-dsi=y
CONFIG_PACKAGE_kmod-drm-sun8i-hdmi=y
CONFIG_PACKAGE_kmod-eeprom-93cx6=m
CONFIG_PACKAGE_kmod-eeprom-at24=y
CONFIG_PACKAGE_kmod-fb=y
CONFIG_PACKAGE_kmod-fb-cfb-copyarea=y
CONFIG_PACKAGE_kmod-fb-cfb-fillrect=y
CONFIG_PACKAGE_kmod-fb-cfb-imgblt=y
CONFIG_PACKAGE_kmod-fb-sys-fops=y
CONFIG_PACKAGE_kmod-fb-sys-ram=y
CONFIG_PACKAGE_kmod-input-core=y
CONFIG_PACKAGE_kmod-input-evdev=y
CONFIG_PACKAGE_kmod-input-touchscreen-goodix=y
CONFIG_PACKAGE_kmod-mac80211=y
CONFIG_PACKAGE_kmod-nf-nat6=y
CONFIG_PACKAGE_kmod-pwm-sun8i=y
CONFIG_PACKAGE_kmod-rtc-pcf8563=y
CONFIG_PACKAGE_kmod-sound-core=y
CONFIG_PACKAGE_kmod-sound-soc-core=y
CONFIG_PACKAGE_kmod-sound-soc-sunxi=y
CONFIG_PACKAGE_kmod-xradio=y
CONFIG_PACKAGE_libcleri=y
CONFIG_PACKAGE_libexpat=y
CONFIG_PACKAGE_libfreetype=y
CONFIG_PACKAGE_libiconv-full-full=m
CONFIG_PACKAGE_libinput=y
CONFIG_PACKAGE_libiwinfo-lua=y
CONFIG_PACKAGE_libjpeg-turbo=y
CONFIG_PACKAGE_libpcre2=y
CONFIG_PACKAGE_libpcre2-16=y
CONFIG_PACKAGE_libpng=y
CONFIG_PACKAGE_libuv=y
# CONFIG_PACKAGE_libwolfssl is not set
CONFIG_PACKAGE_libzstd=y
CONFIG_PACKAGE_luci-app-ser2net=y
CONFIG_PACKAGE_luci-i18n-base-zh-cn=y
CONFIG_PACKAGE_luci-i18n-firewall-zh-cn=y
CONFIG_PACKAGE_luci-i18n-freeioe-zh-cn=y
CONFIG_PACKAGE_luci-i18n-opkg-zh-cn=y
CONFIG_PACKAGE_luci-i18n-ser2net-zh-cn=y
CONFIG_PACKAGE_mtdev=y
CONFIG_PACKAGE_qt-launcher=y
CONFIG_PACKAGE_qt5base-core=y
CONFIG_PACKAGE_qt5base-gui=y
CONFIG_PACKAGE_qt5base-network=y
CONFIG_PACKAGE_qt5base-plugin-imageformats-ico=y
CONFIG_PACKAGE_qt5base-plugin-imageformats-jpeg=y
CONFIG_PACKAGE_qt5base-plugin-input-evdevkeyboard=y
CONFIG_PACKAGE_qt5base-plugin-input-evdevmouse=y
CONFIG_PACKAGE_qt5base-plugin-input-evdevtouch=y
CONFIG_PACKAGE_qt5base-plugin-input-libinput=y
CONFIG_PACKAGE_qt5base-plugin-platforms-linuxfb=y
CONFIG_PACKAGE_qt5base-plugin-platforms-minimal=y
CONFIG_PACKAGE_qt5base-plugin-platforms-offscreen=y
CONFIG_PACKAGE_qt5base-plugin-platforms-vnc=y
CONFIG_PACKAGE_qt5base-plugin-sqldrivers-sqlite=y
CONFIG_PACKAGE_qt5base-printSupport=y
CONFIG_PACKAGE_qt5base-sql=y
CONFIG_PACKAGE_qt5base-widgets=y
CONFIG_PACKAGE_qt5base-xml=y
CONFIG_PACKAGE_qt5quick2-controls=y
CONFIG_PACKAGE_qt5quick2-qml=y
CONFIG_PACKAGE_qt5quick2-qml-models=y
CONFIG_PACKAGE_qt5quick2-qml-module-qtquick-layouts=y
CONFIG_PACKAGE_qt5quick2-qml-module-qtquick-window2=y
CONFIG_PACKAGE_qt5quick2-quick=y
CONFIG_PACKAGE_qt5quick2-quick-widgets=y
CONFIG_PACKAGE_qt5websockets=y
CONFIG_PACKAGE_rpi-big-qt-face=y
CONFIG_PACKAGE_rpi-monitoring=y
CONFIG_PACKAGE_siridb-server=y
CONFIG_PACKAGE_wpad-basic-mbedtls=y
# CONFIG_PACKAGE_wpad-basic-wolfssl is not set
CONFIG_PACKAGE_yajl=y
CONFIG_PCRE2_JIT_ENABLED=y
CONFIG_SUNXI_SD_BOOT_PARTSIZE=20
CONFIG_TARGET_ROOTFS_PARTSIZE=256
# CONFIG_WOLFSSL_HAS_OPENVPN is not set
# CONFIG_WPA_WOLFSSL is not set
CONFIG_ZSTD_OPTIMIZE_O3=y
```

## thingslink/tlink_qh-x40_defconfig
```kconfig
CONFIG_TARGET_sunxi=y
CONFIG_TARGET_sunxi_cortexa7=y
CONFIG_TARGET_sunxi_cortexa7_DEVICE_kooiot_tlink-qh-x40=y
CONFIG_KERNEL_IO_URING=y
# CONFIG_LIBCURL_UNIX_SOCKETS is not set
CONFIG_LUCI_LANG_zh_Hans=y
# CONFIG_OPENSSL_WITH_IDEA is not set
# CONFIG_OPENSSL_WITH_MDC2 is not set
# CONFIG_OPENSSL_WITH_SEED is not set
# CONFIG_OPENSSL_WITH_WHIRLPOOL is not set
CONFIG_PACKAGE_kmod-nf-nat6=y
CONFIG_PACKAGE_libiwinfo-lua=y
# CONFIG_PACKAGE_libwolfssl is not set
CONFIG_PACKAGE_luci-i18n-base-zh-cn=y
CONFIG_PACKAGE_luci-i18n-ddns-zh-cn=y
CONFIG_PACKAGE_luci-i18n-firewall-zh-cn=y
CONFIG_PACKAGE_luci-i18n-freeioe-zh-cn=y
CONFIG_PACKAGE_luci-i18n-opkg-zh-cn=y
CONFIG_PACKAGE_luci-i18n-ser2net-zh-cn=y
CONFIG_PACKAGE_luci-lib-ipkg=y
CONFIG_PACKAGE_wpad-basic-mbedtls=y
# CONFIG_PACKAGE_wpad-basic-wolfssl is not set
CONFIG_SUNXI_SD_BOOT_PARTSIZE=20
CONFIG_TARGET_ROOTFS_PARTSIZE=256
# CONFIG_WOLFSSL_HAS_OPENVPN is not set
# CONFIG_WPA_WOLFSSL is not set
```

## thingslink/tlink_r7_defconfig
```kconfig
CONFIG_TARGET_rockchip=y
CONFIG_TARGET_rockchip_armv8=y
CONFIG_TARGET_rockchip_armv8_DEVICE_kooiot_tlink-r7=y
CONFIG_ATH_USER_REGD=y
CONFIG_DRIVER_11AX_SUPPORT=y
CONFIG_KERNEL_PAGE_POOL=y
CONFIG_LUCI_LANG_zh_Hans=y
CONFIG_PACKAGE_ATH_DFS=y
CONFIG_PACKAGE_MAC80211_DEBUGFS=y
CONFIG_PACKAGE_MAC80211_MESH=y
CONFIG_PACKAGE_canutils=y
CONFIG_PACKAGE_canutils-candump=y
CONFIG_PACKAGE_canutils-canfdtest=y
CONFIG_PACKAGE_canutils-cangen=y
CONFIG_PACKAGE_canutils-cangw=y
CONFIG_PACKAGE_canutils-canplayer=y
CONFIG_PACKAGE_canutils-cansend=y
CONFIG_PACKAGE_canutils-cansniffer=y
CONFIG_PACKAGE_canutils-isotprecv=y
CONFIG_PACKAGE_canutils-isotpsend=y
CONFIG_PACKAGE_comgt-ncm=y
CONFIG_PACKAGE_ip-full=y
CONFIG_PACKAGE_kmod-ath=y
CONFIG_PACKAGE_kmod-ath6kl=y
CONFIG_PACKAGE_kmod-ath6kl-usb=y
CONFIG_PACKAGE_kmod-can-bcm=y
CONFIG_PACKAGE_kmod-can-raw=y
CONFIG_PACKAGE_kmod-can-rockchip-can-fd=y
CONFIG_PACKAGE_kmod-crypto-aead=y
CONFIG_PACKAGE_kmod-crypto-ccm=y
CONFIG_PACKAGE_kmod-crypto-cmac=y
CONFIG_PACKAGE_kmod-crypto-ctr=y
CONFIG_PACKAGE_kmod-crypto-gcm=y
CONFIG_PACKAGE_kmod-crypto-geniv=y
CONFIG_PACKAGE_kmod-crypto-gf128=y
CONFIG_PACKAGE_kmod-crypto-ghash=y
CONFIG_PACKAGE_kmod-crypto-hmac=y
CONFIG_PACKAGE_kmod-crypto-manager=y
CONFIG_PACKAGE_kmod-crypto-null=y
CONFIG_PACKAGE_kmod-crypto-rng=y
CONFIG_PACKAGE_kmod-crypto-seqiv=y
CONFIG_PACKAGE_kmod-crypto-sha3=y
CONFIG_PACKAGE_kmod-crypto-sha512=y
CONFIG_PACKAGE_kmod-hwmon-core=y
CONFIG_PACKAGE_kmod-lib-cordic=y
CONFIG_PACKAGE_kmod-lib-crc8=y
CONFIG_PACKAGE_kmod-mac80211=y
CONFIG_PACKAGE_kmod-mt76-connac=y
CONFIG_PACKAGE_kmod-mt76-core=y
CONFIG_PACKAGE_kmod-mt76-usb=y
CONFIG_PACKAGE_kmod-mt7601u=y
CONFIG_PACKAGE_kmod-mt76x0-common=y
CONFIG_PACKAGE_kmod-mt76x02-common=y
CONFIG_PACKAGE_kmod-mt76x02-usb=y
CONFIG_PACKAGE_kmod-mt76x0u=y
CONFIG_PACKAGE_kmod-mt76x2-common=y
CONFIG_PACKAGE_kmod-mt76x2u=y
CONFIG_PACKAGE_kmod-mt7921-common=y
CONFIG_PACKAGE_kmod-mt7921-firmware=y
CONFIG_PACKAGE_kmod-mt7921u=y
CONFIG_PACKAGE_kmod-mt792x-common=y
CONFIG_PACKAGE_kmod-mt792x-usb=y
CONFIG_PACKAGE_kmod-phy-realtek=y
CONFIG_PACKAGE_kmod-r8169=y
CONFIG_PACKAGE_kmod-rt2800-lib=y
CONFIG_PACKAGE_kmod-rt2800-usb=y
CONFIG_PACKAGE_kmod-rt2x00-lib=y
CONFIG_PACKAGE_kmod-rt2x00-usb=y
CONFIG_PACKAGE_kmod-rtl8192c-common=y
CONFIG_PACKAGE_kmod-rtl8192cu=y
CONFIG_PACKAGE_kmod-rtlwifi=y
CONFIG_PACKAGE_kmod-rtlwifi-usb=y
CONFIG_PACKAGE_kmod-usb-net-huawei-cdc-ncm=y
CONFIG_PACKAGE_libbpf=y
CONFIG_PACKAGE_libcleri=y
CONFIG_PACKAGE_libelf=y
CONFIG_PACKAGE_libgd=y
CONFIG_PACKAGE_libiconv-full-full=m
CONFIG_PACKAGE_libinih=y
CONFIG_PACKAGE_libjpeg-turbo=y
CONFIG_PACKAGE_libkmod=y
CONFIG_PACKAGE_libpci=y
CONFIG_PACKAGE_libpcre2=y
CONFIG_PACKAGE_libpng=y
CONFIG_PACKAGE_libusb-compat=y
CONFIG_PACKAGE_libuv=y
CONFIG_PACKAGE_libwebp=y
CONFIG_PACKAGE_luci-i18n-base-zh-cn=y
CONFIG_PACKAGE_luci-i18n-firewall-zh-cn=y
CONFIG_PACKAGE_luci-i18n-freeioe-zh-cn=y
CONFIG_PACKAGE_luci-i18n-package-manager-zh-cn=y
CONFIG_PACKAGE_luci-proto-ncm=y
CONFIG_PACKAGE_minicom=y
CONFIG_PACKAGE_mt7601u-firmware=y
CONFIG_PACKAGE_pciids=y
CONFIG_PACKAGE_pciutils=y
CONFIG_PACKAGE_r8169-firmware=y
CONFIG_PACKAGE_rt2800-usb-firmware=y
CONFIG_PACKAGE_rtl8192cu-firmware=y
CONFIG_PACKAGE_shellinabox=y
CONFIG_PACKAGE_siridb-server=y
CONFIG_PACKAGE_tio=y
CONFIG_PACKAGE_yajl=y
CONFIG_TARGET_KERNEL_PARTSIZE=30
CONFIG_TARGET_ROOTFS_PARTSIZE=256
```
